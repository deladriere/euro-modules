
/* _______  _______  _______  _______  _______  _        _______ 
(  ____ \(  ____ \(  ____ )(  ____ \(  ___  )( \      (  ____ \
| (    \/| (    \/| (    )|| (    \/| (   ) || (      | (    \/
| |      | (__    | (____)|| (__    | (___) || |      | (_____ 
| |      |  __)   |     __)|  __)   |  ___  || |      (_____  )
| |      | (      | (\ (   | (      | (   ) || |            ) |
| (____/\| (____/\| ) \ \__| (____/\| )   ( || (____/\/\____) |
(_______/(_______/|/   \__/(_______/|/     \|(_______/\_______)
                                                               
 *
 * Granulising samleplayer for GinkoSynthese Grains
 *
 * based on Rob Bothof´s modification of speaker_pcm arduino example by Michael Smith <michael@hurts.ca>
 * http://playground.arduino.cc/Code/PCMAudio
 *
 * Finetuned by Leoš Hort
 * https://www.facebook.com/HRTLmuzik
 * 
 * 
 * 
 * The basic sample is encoded from Harrogath theme of DIABLO 2 LOD soundtrack for experimentation purposes.  
 * 
 * 
 * To encode your own sample, download Processing app and take a look here:
 * sample encoding: http://highlowtech.org/?p=1963
 * 
 * 
 * 
 * / Modified to run on Talko 1.1 & Talko 1.2  by Jean-Luc Deladrière

// TALKO 1.1 control
// Sound  : sample start
// Pitch : grain size 
// Speed : pitch



// TALKO 1.2 control
// Pitch  : sample start
// Speed : grain size
// Bend : pitch

 *
 */
 
#include <stdint.h>
#include <avr/interrupt.h>
#include <avr/io.h>
#include <avr/pgmspace.h>


// here is sample data, the stream of numbers is encoded sample. Dont forget to change the sounddata_lenghth correctly. You can use some online word counter to find the correct number.
const signed char sounddata_data[] PROGMEM={95, 84, 84, 95, 95, 92, 92, 89, 98, 111, 108, 98, 87,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 141, };

#define SAMPLE_RATE 2000
const int sounddata_length=28926;


int ledPin = 13;
int speakerPin = 3; // Can be either 3 or 11, two PWM outputs connected to Timer 2

volatile uint16_t sample;
volatile uint16_t samplestart;
volatile uint16_t oldsamplestart;
volatile uint16_t looplength;
volatile uint16_t minus;

byte lastSample;


void stopPlayback()
{
    // Disable playback per-sample interrupt.
    TIMSK1 &= ~_BV(OCIE1A);

    // Disable the per-sample timer completely.
    TCCR1B &= ~_BV(CS10);

    // Disable the PWM timer.
    TCCR2B &= ~_BV(CS10);

    digitalWrite(speakerPin, LOW);
}

// This is called at 8000 Hz to load the next sample.
ISR(TIMER1_COMPA_vect) {
    if (sample >= samplestart+looplength) {
        sample = samplestart;
    }
     if (sample >= sounddata_length) {
        sample = samplestart;
    }  

          
    if (sample >= sounddata_length) {
        OCR2B = 127;
    }
    else {
        OCR2B = pgm_read_byte(&sounddata_data[sample]);
    }

    ++sample;
}

void startPlayback()
{
    pinMode(speakerPin, OUTPUT);
    

    // Set up Timer 2 to do pulse width modulation on the speaker
    // pin.

    // Use internal clock (datasheet p.160)
    ASSR &= ~(_BV(EXCLK) | _BV(AS2));

    // Set fast PWM mode  (p.157)
    TCCR2A |= _BV(WGM21) | _BV(WGM20);
    TCCR2B &= ~_BV(WGM22);

    if(speakerPin==11){
        // Do non-inverting PWM on pin OC2A (p.155)
        // On the Arduino this is pin 11.
        TCCR2A = (TCCR2A | _BV(COM2A1)) & ~_BV(COM2A0);
        TCCR2A &= ~(_BV(COM2B1) | _BV(COM2B0));
        // No prescaler (p.158)
        TCCR2B = (TCCR2B & ~(_BV(CS12) | _BV(CS11))) | _BV(CS10);

        // Set initial pulse width to the first sample.
        OCR2A = pgm_read_byte(&sounddata_data[0]);
    } else {
        // Do non-inverting PWM on pin OC2B (p.155)
        // On the Arduino this is pin 3.
        TCCR2A = (TCCR2A | _BV(COM2B1)) & ~_BV(COM2B0);
        TCCR2A &= ~(_BV(COM2A1) | _BV(COM2A0));
        // No prescaler (p.158)
        TCCR2B = (TCCR2B & ~(_BV(CS12) | _BV(CS11))) | _BV(CS10);

        // Set initial pulse width to the first sample.
        OCR2B = pgm_read_byte(&sounddata_data[0]);
    }





    // Set up Timer 1 to send a sample every interrupt.

    cli();

    // Set CTC mode (Clear Timer on Compare Match) (p.133)
    // Have to set OCR1A *after*, otherwise it gets reset to 0!
    TCCR1B = (TCCR1B & ~_BV(WGM13)) | _BV(WGM12);
    TCCR1A = TCCR1A & ~(_BV(WGM11) | _BV(WGM10));

    // No prescaler (p.134)
    TCCR1B = (TCCR1B & ~(_BV(CS12) | _BV(CS11))) | _BV(CS10);

    // Set the compare register (OCR1A).
    // OCR1A is a 16-bit register, so we have to do this with
    // interrupts disabled to be safe.
    OCR1A = F_CPU / SAMPLE_RATE;    // 16e6 / 8000 = 2000

    // Enable interrupt when TCNT1 == OCR1A (p.136)
    TIMSK1 |= _BV(OCIE1A);

    lastSample = pgm_read_byte(&sounddata_data[sounddata_length-1]);
    sample = 0;
    sei();
}


void setup()
{
    pinMode(ledPin, OUTPUT);
    digitalWrite(ledPin, HIGH);
    startPlayback();
    samplestart=0;
    looplength=sounddata_length;
   
}

void loop()
{
    //while (true);
    OCR1A = F_CPU / ( analogRead(3) * 32);
   
    samplestart=analogRead(2)*26+500;

//minimal grainsize, you can make it bigger by adding a number (+?)
    looplength=analogRead(1)*26 + 300;

    minus=analogRead(1)*26 + 300;

    if ( minus > samplestart) { minus = oldsamplestart; }
    
    
    
 // doesnt change retrigger when change the samplestart //   
 if ((samplestart > oldsamplestart + looplength) || 
 
 (samplestart < oldsamplestart - minus ))
 
 {
     sample=samplestart;
     oldsamplestart=samplestart;
    }
    
}


