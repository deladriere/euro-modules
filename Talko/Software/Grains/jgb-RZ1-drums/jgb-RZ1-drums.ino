// amplegrains V1.0
// 
// based on the Auduino code by Peter Knight, revised and finetuned by Ginkosynthese for use with cv inputs. 
// Change to a sample player by Janne G:son Berg (jgb @ muffwiggler)
// Modified to run on Talko 1.1 & Talko 1.2  by Jean-Luc Deladrière

// TALKO 1.1 control
// Sound  : Pitch CV 0-5 V
// Pitch : Play on / off. Set it to max for normal function 
// Speed : SAMPLE_SELECT between two wavetables 0-5 V



// TALKO 1.2 control
// Pitch  : Pitch CV 0-5 V
// Speed : Play on / off. Set it to max for normal function 
// Bend : SAMPLE_SELECT between two wavetables 0-5 V

// output
// Digital 3: Audio out (PWM)


#include <avr/io.h>
#include <avr/interrupt.h>
#include <avr/pgmspace.h>

uint16_t syncPhaseAcc;
uint16_t syncPhaseInc;
uint16_t sampleStep;

uint8_t selectedSample;
uint16_t output;
bool play;

boolean clockHigh;
boolean previousClockHigh;
uint16_t trigger;
uint8_t bitmask;
uint8_t stabilizer;


// Map Analogue channels
#define FREQUENCY         (1)
#define TRIGGER_AND_DECAY  (2)
#define SAMPLE_SELECT  (3)

// Changing these will also requires rewriting audioOn()
//    Output is on pin 11
#define PWM_PIN       3
#define PWM_VALUE     OCR2B
#define LED_PIN       13
#define LED_PORT      PORTB
#define LED_BIT       5
#define PWM_INTERRUPT TIMER2_OVF_vect

// For converting incoming CV to pitch

const uint16_t freqTable[] = {
549, 552, 556, 559, 563, 566, 570, 574, 577, 581, 585, 588,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 13935, 
};

// #define KICK 3654
#define KICK 734
#define SNARE 1295
#define LOWTOM 1528
#define MIDTOM 1549
#define HITOM 1656
#define CLAP 979
#define RIMSHOT 547
#define COWBELL 757
#define CHH 582
#define OHH 4852
#define RIDE 5388
#define CRASH 5420


// Define sample parameters
#define MAX_SAMPLES KICK+SNARE+LOWTOM+MIDTOM+HITOM+CLAP+RIMSHOT+COWBELL+CHH+OHH+RIDE+CRASH+4
// Samples to play
const uint8_t sample[MAX_SAMPLES] PROGMEM = {
// Kick
// 128, 128, 128, 128, 128, 128, 128, 128, 128, 128, 128, 128, 127,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 128, 
127, 125, 122, 121, 117, 113, 108, 101, 96, 103, 128, 117,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 127,

// Snare
126, 130, 125, 130, 125, 128, 126, 127, 123, 130, 122, 131,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 128,

// Low tom
127, 127, 127, 128, 127, 128, 126, 127, 126, 129, 125, 129,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 128, 

// Mid tom
127, 127, 127, 127, 127, 127, 127, 127, 127, 126, 126, 128,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 128, 

// Hi tom
127, 127, 127, 127, 127, 128, 127, 127, 127, 127, 126, 127,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 128, 

// Handclap
128, 128, 128, 127, 128, 127, 127, 128, 127, 127, 129, 126,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 128, 

// Rimshot
127, 129, 126, 130, 126, 132, 131, 122, 135, 142, 135, 104,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 128, 

// Cowbell
128, 127, 128, 127, 124, 130, 127, 126, 126, 130, 129, 126,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 128,

// Closed hihat
128, 128, 127, 128, 127, 127, 128, 128, 127, 128, 127, 127,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 128, 
// Open hihat
127, 127, 127, 128, 128, 127, 127, 127, 127, 128, 128, 127,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 128, 

// Ride cymbal
127, 127, 128, 128, 128, 127, 127, 127, 128, 127, 128, 127,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 128,

// Crash cymbal
128, 127, 128, 127, 128, 127, 128, 127, 128, 129, 126, 127,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 127, 

// Additional 
127, 127, 127, 127
};

const uint16_t sampleStart[] = {
  0,
  KICK,
  KICK+SNARE,
  KICK+SNARE+LOWTOM,
  KICK+SNARE+LOWTOM+MIDTOM,
  KICK+SNARE+LOWTOM+MIDTOM+HITOM,
  KICK+SNARE+LOWTOM+MIDTOM+HITOM+CLAP,
  KICK+SNARE+LOWTOM+MIDTOM+HITOM+CLAP+RIMSHOT,
  KICK+SNARE+LOWTOM+MIDTOM+HITOM+CLAP+RIMSHOT+COWBELL,
  KICK+SNARE+LOWTOM+MIDTOM+HITOM+CLAP+RIMSHOT+COWBELL+CHH,
  KICK+SNARE+LOWTOM+MIDTOM+HITOM+CLAP+RIMSHOT+COWBELL+CHH+OHH,
  KICK+SNARE+LOWTOM+MIDTOM+HITOM+CLAP+RIMSHOT+COWBELL+CHH+OHH+RIDE, // End of normal drums, start position for crash cymbal
  KICK+SNARE, // Start position for all toms
  KICK+SNARE+LOWTOM+MIDTOM+HITOM+CLAP+RIMSHOT+COWBELL+CHH+OHH, // Start position for cymbals
  0, // All samples
  0, // Silent
};

const uint16_t sampleLength[] = {
  KICK,
  SNARE,
  LOWTOM,
  MIDTOM,
  LOWTOM,
  CLAP,
  RIMSHOT,
  COWBELL,
  CHH,
  OHH,
  RIDE,
  CRASH,
  LOWTOM+MIDTOM+HITOM, // Length for all toms
  RIDE+CRASH, // Length for ride + crash
  KICK+SNARE+LOWTOM+MIDTOM+HITOM+CLAP+RIMSHOT+COWBELL+CHH+OHH+RIDE+CRASH, // Length for all samples
  0, // Silent
};


void audioOn() {
  // Set up PWM to 31.25kHz, phase accurate

    TCCR2A = _BV(COM2B1) | _BV(WGM20);
  TCCR2B = _BV(CS20);
  TIMSK2 = _BV(TOIE2);
}


void setup() {
  pinMode(PWM_PIN,OUTPUT);
  audioOn();
  pinMode(LED_PIN,OUTPUT);

  stabilizer = 0;
  bitmask = 0;
  sampleStep=0;
  play = false;
  clockHigh = false;
  previousClockHigh = false;
  Serial.begin(9600);
}

void loop() {
  syncPhaseInc = (freqTable[(analogRead(FREQUENCY)) >> 1] << 2);

  selectedSample = analogRead(SAMPLE_SELECT) >> 6;

  // Get triggers and decay values
  trigger = analogRead(TRIGGER_AND_DECAY);

  // Going from low to high, ie incoming clock pulse
  if ((trigger > 128) && !clockHigh)
  {
    clockHigh = true;
    sampleStep = 0;
    stabilizer = 4;    
    play = true;
    
  }

  // Going from high to low, end of incoming clock pulse
  if ((trigger <= 128) && clockHigh)
  {
    clockHigh = false;
  }

  if ((trigger > 128) && clockHigh)
  {
    if (stabilizer > 0)
    {
      // Do not read the rising edge, wait until the clock has stabilized on the high value
      if (stabilizer-- == 1)
      {
        bitmask = ~((1024-trigger) >> 3);
        Serial.println(bitmask);        }
    }
  }
}

SIGNAL(PWM_INTERRUPT)
{

  syncPhaseAcc += syncPhaseInc;
  if ((syncPhaseAcc < syncPhaseInc) && play) {
    // Time to increase the sample step
    if ( ++sampleStep >= sampleLength[selectedSample]) {
      play = false;
      output = 128;
    }
    else {
      output = pgm_read_byte(&sample[sampleStart[selectedSample] + sampleStep]);
      output ^= bitmask;
    }
  }
  // Output to PWM (this is faster than using analogWrite)  
  PWM_VALUE = output;
}

