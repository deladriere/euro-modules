
#include <EnableInterrupt.h>
#include "talkietz.h"
#include <SimpleTimer.h>

// library from :  https://github.com/GreyGnome/EnableInterrupt/wiki/Usage#Summary

// Modify this at your leisure. Refer to https://github.com/GreyGnome/EnableInterrupt/wiki/Usage#Summary
#define PINA 7 // capa 100 nf to ground
#define PINB 6  // capa 100 nf to ground

/*
   ██    ██  █████  ██████  ██  █████  ██████  ██      ███████ ███████
   ██    ██ ██   ██ ██   ██ ██ ██   ██ ██   ██ ██      ██      ██
   ██    ██ ███████ ██████  ██ ███████ ██████  ██      █████   ███████
    ██  ██  ██   ██ ██   ██ ██ ██   ██ ██   ██ ██      ██           ██
     ████   ██   ██ ██   ██ ██ ██   ██ ██████  ███████ ███████ ███████
 */

// Pin matching from 4511 to Aduino
const int LedA = 9;
const int LedB = 10;
const int LedC = 11;
const int LedD = 12;

int i;
int count = 0;
int target = 1;
int left= 0;
bool run = 0;
int timerId;
volatile int state = LOW;
volatile int interruptCount = 0; // The rotary counter


Talkie voice;
SimpleTimer timer;

const uint8_t spZERO[]     PROGMEM = {0x69, 0xFB, 0x59, 0xDD, 0x51, 0xD5, 0xD7, 0xB5, 0x6F, 0x0A, 0x78, 0xC0, 0x52,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 0xFF, 0x1F};
const uint8_t spONE[]      PROGMEM = {0x66, 0x4E, 0xA8, 0x7A, 0x8D, 0xED, 0xC4, 0xB5, 0xCD, 0x89, 0xD4, 0xBC, 0xA2,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 0xFE, 0x1F};
const uint8_t spTWO[]      PROGMEM = {0x06, 0xB8, 0x59, 0x34, 0x00, 0x27, 0xD6, 0x38, 0x60, 0x58, 0xD3, 0x91, 0x55,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 0xFF, 0x1F};
const uint8_t spTHREE[]    PROGMEM = {0x0C, 0xE8, 0x2E, 0x94, 0x01, 0x4D, 0xBA, 0x4A, 0x40, 0x03, 0x16, 0x68, 0x69,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 0xFF, 0x03};
const uint8_t spFOUR[]     PROGMEM = {0x08, 0x68, 0x21, 0x0D, 0x03, 0x04, 0x28, 0xCE, 0x92, 0x03, 0x23, 0x4A, 0xCA,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 0xF2, 0xFF};
const uint8_t spFIVE[]     PROGMEM = {0x08, 0x68, 0x4E, 0x9D, 0x02, 0x1C, 0x60, 0xC0, 0x8C, 0x69, 0x12, 0xB0, 0xC0,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 0xFF, 0x01};
const uint8_t spSIX[]      PROGMEM = {0x04, 0xF8, 0xAD, 0x4C, 0x02, 0x16, 0xB0, 0x80, 0x06, 0x56, 0x35, 0x5D, 0xA8,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 0xFF, 0x01};
const uint8_t spSEVEN[]    PROGMEM = {0x0C, 0xF8, 0x5E, 0x4C, 0x01, 0xBF, 0x95, 0x7B, 0xC0, 0x02, 0x16, 0xB0, 0xC0,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 0xFB, 0x7F};
const uint8_t spEIGHT[]    PROGMEM = {0x65, 0x69, 0x89, 0xC5, 0x73, 0x66, 0xDF, 0xE9, 0x8C, 0x33, 0x0E, 0x41, 0xC6,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 0xF8, 0x7F};
const uint8_t spNINE[]     PROGMEM = {0xE6, 0xA8, 0x1A, 0x35, 0x5D, 0xD6, 0x9A, 0x35, 0x4B, 0x8C, 0x4E, 0x6B, 0x1A,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 0xFF, 0x0F};
const uint8_t spTEN[]      PROGMEM = {0x0E, 0x38, 0x3C, 0x2D, 0x00, 0x5F, 0xB6, 0x19, 0x60, 0xA8, 0x90, 0x93, 0x36,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 0xFF, 0x03};
const uint8_t spELEVEN[]   PROGMEM = {0xA5, 0xEF, 0xD6, 0x50, 0x3B, 0x67, 0x8F, 0xB9, 0x3B, 0x23, 0x49, 0x7F, 0x33,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 0xFF, 0x0F};
const uint8_t spTWELVE[]   PROGMEM = {0x09, 0x98, 0xDA, 0x22, 0x01, 0x37, 0x78, 0x1A, 0x20, 0x85, 0xD1, 0x50, 0x3A,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 0xFE, 0x1F};
const uint8_t spTHIR_[]    PROGMEM = {0x04, 0xA8, 0xBE, 0x5C, 0x00, 0xDD, 0xA5, 0x11, 0xA0, 0xFA, 0x72, 0x02, 0x74,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 0xFF, 0x03};
const uint8_t spFIF_[]     PROGMEM = {0x08, 0x98, 0x31, 0x93, 0x02, 0x1C, 0xE0, 0x80, 0x07, 0x5A, 0xD6, 0x1C, 0x6B,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 0xFC, 0x3F};
const uint8_t sp_TEEN[]    PROGMEM = {0x09, 0x58, 0x2A, 0x25, 0x00, 0xCB, 0x9F, 0x95, 0x6C, 0x14, 0x21, 0x89, 0xA9,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 0xFF, 0x3F};
const uint8_t spTWENTY[]   PROGMEM = {0x0A, 0xE8, 0x4A, 0xCD, 0x01, 0xDB, 0xB9, 0x33, 0xC0, 0xA6, 0x54, 0x0C, 0xA4,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 0xFF, 0x1F};
const uint8_t spT[]        PROGMEM = {0x01, 0xD8, 0xB6, 0xDD, 0x01, 0x2F, 0xF4, 0x38, 0x60, 0xD5, 0xD1, 0x91, 0x4D,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 0xFF, 0x07};
const uint8_t spHUNDRED[]  PROGMEM = {0x04, 0xC8, 0x7E, 0x5C, 0x02, 0x0A, 0xA8, 0x62, 0x43, 0x03, 0xA7, 0xA8, 0x62,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 0xF9, 0x7F};
const uint8_t spTHOUSAND[] PROGMEM = {0x0C, 0xE8, 0x2E, 0xD4, 0x02, 0x06, 0x98, 0xD2, 0x55, 0x03, 0x16, 0x68, 0x7D,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 0xFF, 0x0F};
const uint8_t spAND[]      PROGMEM = {0xA9, 0x6B, 0x21, 0xB9, 0x22, 0x66, 0x9F, 0xAE, 0xC7, 0xE1, 0x70, 0x7B, 0x72,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 0xFF, 0x3F};
const uint8_t spMINUS[]    PROGMEM = {0xE6, 0x28, 0xC4, 0xF8, 0x44, 0x9A, 0xFB, 0xCD, 0xAD, 0x8D, 0x2A, 0x4E, 0x4A,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 0xFF, 0x03};

const uint8_t spTack[]     PROGMEM = {0x01, 0x7A, 0xAA, 0xB5, 0x6E, 0xCB, 0xD0, 0x0E, 0xAD, 0x6E, 0xAF, 0xEE, 0xF9,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 0xFE, 0x1F};
const uint8_t spTick[]     PROGMEM = {0x01, 0xFF, 0xAB, 0xB5, 0x6E, 0xCB, 0xD0, 0x0E, 0xAD, 0x6E, 0xAF, 0xEE, 0xF9,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 0xFE, 0x1F};
const uint8_t spPONG[]     PROGMEM = { 0xCB, 0xD0, 0xAB, 0xCD, 0x89, 0x8F, 0x7F, 0xFE, 0x1F};
const uint8_t spBEEP[]     PROGMEM = { 0xCB, 0xD0, 0xAB, 0xCD, 0x89, 0x10, 0xFF, 0xFF, 0x1F};
const uint8_t spTut[]     PROGMEM = { 0xCB, 0x40, 0x50, 0xCD, 0xFF, 0x20, 0xFF, 0xFF, 0x1F};
const uint8_t spToc[]     PROGMEM = { 0xCB, 0xD0, 0x00, 0xCD, 0x89, 0xFF, 0xFF, 0xFF, 0x1F};


const uint8_t spTONEti[]      PROGMEM  ={0x09,0x98,0xCA,0xD2,0x01,0x4B,0x5B,0x09,0x20,0xC4,0xB2,0x13,0x06,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0x00,0x00};
const uint8_t spTONE1aa[]     PROGMEM = {0x8D,0xF2,0xDE,0xDD,0xDD,0x93,0x74,0xAA,0x53,0x9D,0xEA,0x54,0xA7,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0x15,0x0A};
const uint8_t spTONE2aa[]    PROGMEM   = {0x4D,0xF1,0xDE,0xDD,0xDD,0x93,0x74,0xA5,0x2B,0x5D,0xE9,0x4A,0x57,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0x11,0x5A};
const uint8_t spMINUTES[]       PROGMEM = {0x61,0xCA,0xCC,0x38,0x5B,0x9A,0xE6,0xA9,0xB6,0xA7,0xEC,0x2A,0xC5,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0xFF,0x01};

const uint8_t spTIMER[]         PROGMEM = {0x0E,0xB8,0x36,0xC3,0x01,0xCD,0x98,0xB4,0x38,0x87,0x8C,0x0A,0x59,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0xFE,0x1F};
const uint8_t spIS[]            PROGMEM = {0xAD,0xED,0xD5,0x58,0xA4,0x9E,0xCE,0x76,0xF5,0xDD,0xAB,0x29,0xF5,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0xF0,0xFF};
const uint8_t spCOMPLETE[]      PROGMEM = {0x0E,0x68,0xA1,0x43,0x03,0xA7,0x2E,0xB2,0x22,0x0B,0xBB,0xDC,0x76,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0xFC,0x7F};
const uint8_t spCIRCUIT[]       PROGMEM = {0x02,0x78,0x2D,0x55,0x02,0x12,0xB0,0x80,0x01,0x5E,0x49,0x5D,0x49,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0xFF,0x3F};
const uint8_t spTHE[] PROGMEM = {0x08,0x20,0xBA,0x0D,0x03,0x69,0xDF,0xA8,0xCD,0x85,0x3B,0xD7,0x79,0xF4,0x59,0xB7,0xA9,0xFA,0xA2,0xD5,0x27,0xD9,0x6E,0x11,0x8B,0xC6,0x90,0xB4,0x47,0xA8,0x6D,0xFA,0x7F};


/*
   ███████ ███████ ████████ ██    ██ ██████
   ██      ██         ██    ██    ██ ██   ██
   ███████ █████      ██    ██    ██ ██████
        ██ ██         ██    ██    ██ ██
   ███████ ███████    ██     ██████  ██
 */

void setup() {
        // initialize serial communication at 9600 bits per second:
        Serial.begin(19200);

        pinMode(4, INPUT_PULLUP);
        pinMode(5, INPUT_PULLUP);
        pinMode(2, INPUT_PULLUP);
        pinMode(8, INPUT_PULLUP);


        pinMode(LedA, OUTPUT);
        pinMode(LedB, OUTPUT);
        pinMode(LedC, OUTPUT);
        pinMode(LedD, OUTPUT);
        pinMode(13, OUTPUT);
        pinMode(17, OUTPUT); // bend port
        digitalWrite(17,HIGH);

        pinMode(PINA, INPUT_PULLUP); // See http://arduino.cc/en/Tutorial/DigitalPins
        pinMode(PINB, INPUT_PULLUP);
        interruptCount = 0;
        display(1);
        enableInterrupt(PINA, rot, CHANGE);
        timerId = timer.setInterval(1000L, blink);
        timer.disable(timerId);

        //attachInterrupt(0, blink, CHANGE); verifier si ok avec rotary

        voice.SetSpeed(800); //entre 0 et 1023 . augmenter la valeur pour augmenter la vitesse. Valeur normal=800
        voice.SetPitch(700);        //entre 0 et 1023 : Pitch normal=700. Augmenter pour rendre la voix plus aigue
        voice.BendingOff();

}

/*
   ███████ ██    ██ ███    ██  ██████ ████████ ██  ██████  ███    ██ ███████
   ██      ██    ██ ████   ██ ██         ██    ██ ██    ██ ████   ██ ██
   █████   ██    ██ ██ ██  ██ ██         ██    ██ ██    ██ ██ ██  ██ ███████
   ██      ██    ██ ██  ██ ██ ██         ██    ██ ██    ██ ██  ██ ██      ██
   ██       ██████  ██   ████  ██████    ██    ██  ██████  ██   ████ ███████
 */

void Alarm()
{
        if (!digitalRead(4)) {
                for (size_t i = 0; i < 15; i++) {
                        voice.say(spBEEP);
                }
                voice.say(spTHE);
                voice.say(spCIRCUIT);
                voice.say(spIS);
                voice.say(spCOMPLETE);

        }
}

void Stop()
{
        timer.disable(timerId);

        digitalWrite(17,HIGH);
        run = LOW;
        enableInterrupt(PINA, rot, CHANGE);
        /*
           voice.say(spBEEP);
           voice.say(spBEEP);
           voice.say(spTONE1aa);
           voice.say(spBEEP);
           voice.say(spTONE2aa);
           voice.say(spBEEP);
         */
        i=0;
        target=1;
        interruptCount = 0;
        digitalWrite(13, LOW);
        display(1);
        //delay(300);
        Alarm();

}
void blink() {

        if (run)
        {
                i--;
                left= i/60+1;
                Serial.print(i);
                Serial.print(" ");
                Serial.print(left);
                Serial.print(" ");
                Serial.println(i%60);
                if (i<=0) Stop();

        }


        state = !state;
        if (state)
        {
                if (digitalRead(8)) voice.say(spTack);

                display(left % 10);
                if (left >= 10)
                {
                        digitalWrite(13, HIGH);
                }
                else
                {
                        digitalWrite(13, LOW);
                }
        }
        else
        {

                if (digitalRead(8))   voice.say(spTick);
                display(15);
                digitalWrite(13, LOW);
        }
        if (!digitalRead(5))
        {
                if (i%60==0 & left>=1)
                {
                        sayNumber(left);
                        voice.say(spMINUTES);

                }
        }
}

void display(int n)
{

        digitalWrite(LedD, ((n >> 3) & 1) ? HIGH : LOW);
        digitalWrite(LedC, ((n >> 2) & 1) ? HIGH : LOW);
        digitalWrite(LedB, ((n >> 1) & 1) ? HIGH : LOW);
        digitalWrite(LedA, (n & 1) ? HIGH : LOW);

}

/* Say any number between -999,999 and 999,999 */
void sayNumber(long n) {
        if (n < 0) {
                voice.say(spMINUS);
                sayNumber(-n);
        } else if (n == 0) {
                voice.say(spZERO);
        } else {
                if (n >= 1000) {
                        int thousands = n / 1000;
                        sayNumber(thousands);
                        voice.say(spTHOUSAND);
                        n %= 1000;
                        if ((n > 0) && (n < 100)) voice.say(spAND);
                }
                if (n >= 100) {
                        int hundreds = n / 100;
                        sayNumber(hundreds);
                        voice.say(spHUNDRED);
                        n %= 100;
                        if (n > 0) voice.say(spAND);
                }
                if (n > 19) {
                        int tens = n / 10;
                        switch (tens) {
                        case 2: voice.say(spTWENTY); break;
                        case 3: voice.say(spTHIR_); voice.say(spT); break;
                        case 4: voice.say(spFOUR); voice.say(spT);  break;
                        case 5: voice.say(spFIF_);  voice.say(spT); break;
                        case 6: voice.say(spSIX);  voice.say(spT); break;
                        case 7: voice.say(spSEVEN);  voice.say(spT); break;
                        case 8: voice.say(spEIGHT);  voice.say(spT); break;
                        case 9: voice.say(spNINE);  voice.say(spT); break;
                        }
                        n %= 10;
                }
                switch (n) {
                case 1: voice.say(spONE); break;
                case 2: voice.say(spTWO); break;
                case 3: voice.say(spTHREE); break;
                case 4: voice.say(spFOUR); break;
                case 5: voice.say(spFIVE); break;
                case 6: voice.say(spSIX); break;
                case 7: voice.say(spSEVEN); break;
                case 8: voice.say(spEIGHT); break;
                case 9: voice.say(spNINE); break;
                case 10: voice.say(spTEN); break;
                case 11: voice.say(spELEVEN); break;
                case 12: voice.say(spTWELVE); break;
                case 13: voice.say(spTHIR_); voice.say(sp_TEEN); break;
                case 14: voice.say(spFOUR); voice.say(sp_TEEN); break;
                case 15: voice.say(spFIF_); voice.say(sp_TEEN); break;
                case 16: voice.say(spSIX); voice.say(sp_TEEN); break;
                case 17: voice.say(spSEVEN); voice.say(sp_TEEN); break;
                case 18: voice.say(spEIGHT); voice.say(sp_TEEN); break;
                case 19: voice.say(spNINE); voice.say(sp_TEEN); break;
                }
        }
}

// get rotary
void rot()
{

        if (digitalRead(PINB))

                //delay(5);
                if (digitalRead(PINA)) {
                        interruptCount--;
                }
                else
                {

                        interruptCount++;
                }

        interruptCount = constrain(interruptCount, 1, 19);

        target = interruptCount;

        if (target >= 10)
        {
                digitalWrite(13, HIGH);
        }
        else
        {
                digitalWrite(13, LOW);
        }

        display(target % 10);
}



void loop() {
        timer.run();

        voice.SetSpeed(analogRead(2)); //entre 0 et 1023 . augmenter la valeur pour augmenter la vitesse. Valeur normal=800
        voice.SetPitch(analogRead(1)); //entre 0 et 1023 : Pitch normal=700. Augmenter pour rendre la voix plus aigue





        if (!run)
        {
                if (digitalRead(2)  )
                {
                        run = HIGH;
                        digitalWrite(17,LOW);
                        i=target*60;
                        disableInterrupt(PINA);
                        delay(300);
                        timer.enable(timerId);
                }
        }
        else
        {
                if (digitalRead(2))
                {
                        timer.disable(timerId);

                        digitalWrite(17,HIGH);
                        run = LOW;
                        enableInterrupt(PINA, rot, CHANGE);
/*
                        voice.say(spBEEP);
                        voice.say(spBEEP);
                        voice.say(spTONE1aa);
                        voice.say(spBEEP);
                        voice.say(spTONE2aa);
                        voice.say(spBEEP);
 */
                        i=0;
                        target=1;
                        interruptCount = 0;
                        digitalWrite(13, LOW);
                        display(1);
                        delay(300);
                        Alarm();

                }
        }

}
