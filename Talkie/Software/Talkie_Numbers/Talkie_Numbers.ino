// Talkie library
// Copyright 2011 Peter Knight
// This code is released under GPLv2 license.
//
// Add 5 pots to A0,A1,A2,A3,A4 and temporary switch to D5

#include "talkie2.h"

Talkie voice;

// nato alphabet
uint8_t spALPHA[] PROGMEM = {0x63,0xA9,0x21,0xB4,0x3C,0x16,0xAF,0xB6,0x84,0xD2,0x0A,0x5F,0xB3,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0xFD,0xFF};
uint8_t spBRAVO[] PROGMEM = {0x02,0x10,0x2C,0x34,0xB4,0x46,0xAF,0xC8,0x8A,0xBD,0xD4,0x84,0xA9,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0xFE,0x1F};
uint8_t spCHARLIE[] PROGMEM = {0x06,0xD8,0x2D,0x2C,0x01,0x33,0xB7,0x67,0xA0,0xC5,0xC5,0x8D,0xC8,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0xFF,0x1F};
uint8_t spDELTA[] PROGMEM = {0x0A,0x28,0x30,0x6C,0xAD,0xC3,0xA7,0xAA,0x70,0xD7,0xD5,0x76,0x5D,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0xFE,0x1F};
uint8_t spECHO[] PROGMEM = {0x2B,0x6F,0xB1,0xD9,0xD3,0x36,0xDF,0xF6,0x36,0xB7,0x26,0x85,0x08,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0xFC,0x7F};
uint8_t spFOXTROT[] PROGMEM = {0x04,0x18,0xB6,0x82,0x00,0xD3,0x57,0x08,0x60,0xBA,0xF4,0x91,0xC6,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0xFF,0x0F};
uint8_t spGOLF[] PROGMEM = {0x0A,0x88,0xA1,0x71,0x15,0x85,0x76,0x45,0x8A,0xFF,0x9B,0xDF,0x6C,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0xFF,0x03};
uint8_t spHOTEL[] PROGMEM = {0x08,0xC8,0x4A,0x0C,0x01,0xC5,0x74,0x11,0xA0,0xCA,0xEA,0xD1,0x36,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0xFF,0x03};
uint8_t spINDIA[] PROGMEM = {0xA3,0x9D,0xD6,0x99,0x32,0x17,0x8F,0x66,0x86,0x16,0x74,0x5F,0xB3,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0xFA,0x7F};
uint8_t spJULIET[] PROGMEM = {0x61,0x5D,0x96,0x49,0x34,0xD2,0x06,0x60,0xC7,0x90,0x0C,0x8C,0x66,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0xFF,0x07};
uint8_t spKILO[] PROGMEM = {0x06,0xE8,0x12,0xD9,0x02,0x12,0x68,0xE1,0x8C,0x86,0xD4,0xF5,0x76,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0xFF,0x0F};
uint8_t spLIMA[] PROGMEM = {0x61,0x5A,0x90,0xBA,0xC0,0xD7,0xA6,0x69,0x00,0x19,0x85,0x6A,0xDA,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0xFF,0x1F};
uint8_t spMIKE[] PROGMEM = {0x66,0x31,0x3C,0x7C,0x52,0xE3,0xC4,0x69,0xF5,0x85,0x57,0x86,0x51,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0xFE,0x7F};
uint8_t spNOVEMBER[] PROGMEM = {0x66,0x2D,0x02,0x62,0x4B,0xE3,0x8E,0xA5,0xEB,0x10,0x77,0x6E,0xB3,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0xFF,0x01};
uint8_t spOSCAR[] PROGMEM = {0x6B,0xC8,0xE2,0xB2,0x42,0x3A,0xDF,0xFA,0x16,0x27,0x4F,0xAE,0x7D,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0xFC,0x3F};
uint8_t spPAPA[] PROGMEM = {0x0A,0x28,0x56,0xB9,0xA5,0x45,0x55,0x84,0x49,0xCC,0x93,0x66,0xD7,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0xFF,0x03};
uint8_t spQUEBEC[] PROGMEM = {0x0C,0x88,0x7E,0x8C,0x02,0xA5,0x0A,0x31,0xDD,0x5C,0xB2,0xAC,0x26,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0xF8,0x7F};
uint8_t spROMEO[] PROGMEM = {0xA2,0xD5,0x39,0x38,0xCA,0xEC,0xDB,0xA5,0x4C,0xA1,0x98,0x5A,0xB9,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0xFF,0x01};
uint8_t spSIERRA[] PROGMEM = {0x0C,0xF8,0xAD,0x54,0x03,0x06,0xF8,0x2D,0xD5,0x01,0xBF,0x94,0x39,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0xF9,0xFF};
uint8_t spTANGO[] PROGMEM = {0x0E,0xD8,0x5C,0xCD,0x03,0x2B,0x2A,0xD9,0xD4,0x23,0x2B,0xAD,0xB4,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0xF7,0xFF};
uint8_t spUNIFORM[] PROGMEM = {0x61,0x3D,0x56,0x98,0xD4,0xB6,0xE6,0xA5,0x8D,0xC7,0xA8,0x01,0xC5,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0xFD,0x3F};
uint8_t spVICTOR[] PROGMEM = {0x6E,0x6E,0x52,0x55,0xCD,0xDD,0xA8,0xAD,0x72,0x55,0x95,0x70,0xE3,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0xFF,0x07};
uint8_t spWHISKEY[] PROGMEM = {0x04,0x88,0xAE,0x8C,0x03,0x12,0x08,0x51,0x74,0x65,0xE9,0xEC,0x68,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0xFE,0x3F};
uint8_t spXRAY[] PROGMEM = {0xAB,0xAA,0xDE,0xB4,0x62,0x66,0x9F,0xA2,0x75,0x73,0xD3,0x6E,0x72,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0xFE,0x3F};
uint8_t spYANKEE[] PROGMEM = {0x6E,0xEF,0x42,0x58,0xB6,0x6B,0xA7,0x7D,0x68,0x25,0xCC,0x59,0xB4,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0xFF,0x01};
uint8_t spZULU[] PROGMEM = {0x6D,0xFE,0xDE,0xC4,0xC4,0xE8,0x29,0x60,0x00,0x2E,0x0F,0x9C,0x6C,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0xFF,0x07};



//alphabat UK_male

uint8_t spA_A[]         PROGMEM = {0x27,0x5A,0x3E,0x95,0xDB,0xDB,0x9C,0x68,0xDA,0x26,0x6D,0xAF,0x75,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0x61,0x41};
uint8_t spA_B[]         PROGMEM = {0xA9,0xB2,0x56,0x3D,0xBD,0x2B,0x95,0xB8,0x28,0xC1,0x9D,0xAD,0xD5,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0x41,0x21};
uint8_t spA_C[]         PROGMEM = {0x0C,0xF8,0x8A,0x45,0x02,0x1A,0x50,0xC0,0xE7,0x11,0x16,0x30,0xC0,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0x41,0x61};
uint8_t spA_D[]         PROGMEM = {0x0C,0xB8,0xD0,0x64,0x64,0x0F,0x15,0x8B,0x5A,0xE8,0x15,0x6C,0xE1,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0x41,0x11};
uint8_t spA_E[]         PROGMEM = {0x21,0x3A,0x4A,0x41,0x77,0x63,0xCF,0x68,0x27,0x3B,0x1D,0xC5,0x6A,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0x41,0x51};
uint8_t spA_F[]         PROGMEM = {0x23,0x1E,0x29,0x44,0x32,0xE6,0x9C,0x70,0xA6,0x16,0x09,0x9F,0x7D,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0x51,0x31};
uint8_t spA_G[]         PROGMEM = {0xA1,0xDE,0xDD,0x89,0x30,0xD2,0x58,0x60,0x64,0x2B,0x1A,0xB1,0x45,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0x79,0x71};
uint8_t spA_H[]         PROGMEM = {0xC3,0x1B,0xD1,0x29,0xA2,0x6A,0xAF,0x68,0xC6,0x46,0xF3,0x6C,0x74,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0x41,0x09};
uint8_t spA_I[]         PROGMEM = {0x2B,0x2B,0xA5,0x3A,0xCD,0x9B,0x9C,0xB4,0x9A,0x8B,0x08,0x5B,0xB4,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0x19,0x49};
uint8_t spA_J[]         PROGMEM = {0xA1,0xDE,0xDD,0x89,0x30,0xD2,0x68,0x60,0x64,0x2B,0x1A,0xB1,0x45,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0xFD,0x69};
uint8_t spA_K[]         PROGMEM = {0x06,0xA8,0x86,0x99,0x01,0x2D,0x10,0x0D,0x7F,0x04,0xC5,0x0C,0xB7,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0x51,0x69};
uint8_t spA_L[]         PROGMEM = {0x23,0x1A,0x59,0x35,0xD5,0xEB,0xAC,0xA4,0x05,0xC9,0xF0,0xAA,0x73,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0x41,0x19};
uint8_t spA_M[]         PROGMEM = {0x2B,0x1B,0x41,0x55,0x3B,0x9A,0x9C,0x64,0x85,0x34,0x4E,0x6B,0x73,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0x41,0x59};
uint8_t spA_N[]         PROGMEM = {0x27,0x9E,0x71,0x99,0x3D,0x16,0x9D,0x68,0xBA,0x22,0xCB,0xAC,0x75,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0x41,0x39};
uint8_t spA_O[]         PROGMEM = {0x2B,0xC9,0x21,0xCD,0x2C,0x1F,0xEE,0xE4,0xA4,0xC5,0x54,0x9A,0xE9,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0x72,0x79};
uint8_t spA_P[]         PROGMEM = {0x0E,0x18,0x5D,0x29,0x79,0x95,0x93,0x6E,0x8D,0x98,0xE1,0x4E,0xC3,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0x41,0x05};
uint8_t spA_Q[]         PROGMEM = {0x0E,0x58,0x5E,0xD8,0x00,0x3B,0xAA,0x3A,0x60,0xB5,0xF1,0x16,0xF4,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0xFF,0x25};
uint8_t spA_R[]         PROGMEM = {0x23,0x2C,0xEE,0x2A,0x8C,0x57,0xAE,0x28,0xC7,0x4F,0x33,0x5D,0xB8,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0x51,0x25};
uint8_t spA_S[]         PROGMEM = {0x2D,0x9E,0xC9,0x85,0x3B,0x16,0xAF,0x68,0x87,0x31,0x4A,0x6B,0x74,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0x41,0x65};
uint8_t spA_T[]         PROGMEM = {0x0E,0x38,0xC2,0xD4,0x00,0x57,0xB5,0x36,0x77,0x29,0x26,0xCF,0xB6,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0x51,0x15};
uint8_t spA_U[]         PROGMEM = {0xAE,0x5A,0x40,0x2C,0xB7,0xC5,0x84,0x6C,0x42,0xA1,0xD8,0x0D,0x13,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0x09,0x55};
uint8_t spA_V[]         PROGMEM = {0xA6,0x4E,0xCC,0x25,0x42,0x1A,0xB9,0xBA,0x0A,0x23,0x57,0x6E,0xED,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0x51,0x35};
uint8_t spA_W[]         PROGMEM = {0xA3,0xBF,0x2A,0xC2,0x43,0x64,0xAD,0xA4,0xA8,0x94,0xF4,0x5A,0x7C,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0x41,0x75};
uint8_t spA_X[]         PROGMEM = {0xAD,0x18,0x21,0x28,0xCA,0x6A,0x9F,0xA0,0x3B,0xA3,0xCA,0xA8,0x7D,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0xFF,0x4D};
uint8_t spA_Y[]         PROGMEM = {0xA2,0x64,0xA6,0x72,0x4C,0x1C,0xA9,0x42,0xB8,0xE2,0xB6,0x48,0xE4,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0x51,0x4D};
uint8_t spA_Z[]         PROGMEM = {0x08,0x38,0x20,0x4D,0x02,0x12,0x08,0xED,0x05,0x66,0xEE,0x19,0xA7,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0x4E,0xFE};


//alphabet US_male
uint8_t spA[]             PROGMEM = {0x65,0x2C,0x96,0xAD,0x7B,0x6A,0x9F,0x66,0xE4,0x20,0x8D,0x9C,0x73,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0xFF,0x3F};
uint8_t spB[]             PROGMEM = {0xA6,0x2F,0xAA,0x05,0x5C,0xD6,0x8C,0xBC,0xC7,0x16,0x70,0x59,0x33,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0xFF,0x03};
uint8_t spC[]             PROGMEM = {0x04,0xF8,0xA5,0x83,0x03,0x12,0xB0,0x80,0x07,0x22,0xB0,0xC2,0xEE,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0xF3,0xFF};
uint8_t spD[]             PROGMEM = {0x06,0x98,0x30,0x68,0xE4,0x6B,0x84,0xA0,0xE8,0xD3,0x93,0x8D,0xEC,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0xFF,0x0F};
uint8_t spE[]             PROGMEM = {0xA2,0x59,0x95,0x51,0xBA,0x17,0xF7,0x6A,0x95,0xAB,0x38,0x42,0xE4,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0xFF,0x07};
uint8_t spF[]             PROGMEM = {0xAB,0x1B,0x61,0x94,0xDD,0xD6,0xDC,0xF1,0x74,0xDD,0x37,0xB9,0xE7,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0xFF,0x07};
uint8_t spG[]             PROGMEM = {0x6E,0x3F,0x29,0x8D,0x98,0x95,0xCD,0x3D,0x00,0xAB,0x38,0x95,0xE2,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0xF9,0x7F};
uint8_t spH[]             PROGMEM = {0x65,0x18,0x6D,0x90,0x2D,0xD6,0xEC,0xF6,0x56,0xB7,0xBC,0xC5,0xAE,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0xFE,0x1F};
uint8_t spI[]             PROGMEM = {0xAA,0x8D,0x63,0xA8,0xAA,0x66,0xAD,0xB9,0xA8,0xCB,0x08,0xDD,0x7C,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0xFE,0x7F};
uint8_t spL[]             PROGMEM = {0x6B,0x68,0x2E,0xD8,0x2A,0x37,0xDF,0xFE,0xF6,0xA7,0xAF,0x21,0xBC,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0xFF,0x0F};
uint8_t spJ[]             PROGMEM = {0x6E,0x5A,0xC1,0x99,0x54,0xB2,0x09,0x60,0x49,0x22,0x07,0xEC,0xA8,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0xFF,0x07};
uint8_t spK[]             PROGMEM = {0x01,0x18,0x91,0xB9,0x00,0x4D,0x91,0x46,0x60,0x65,0x2D,0xB3,0xB8,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0xFF,0x01};
uint8_t spM[]             PROGMEM = {0xA9,0xE8,0xC5,0xD8,0x73,0x16,0xCF,0xE2,0x0E,0xB7,0xBB,0xCD,0xA9,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0xFF,0x07};
uint8_t spN[]             PROGMEM = {0x41,0xEE,0xD1,0xC8,0xB3,0x16,0xEF,0xEE,0xD4,0xC3,0x35,0x59,0xC4,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0xFF,0x01};
uint8_t spO[]             PROGMEM = {0xA3,0x6D,0xB4,0xBA,0x8D,0xBC,0xAD,0xA6,0x92,0xEC,0x0E,0xF2,0xB6,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0xFF,0x01};
uint8_t spP[]             PROGMEM = {0x02,0x88,0x26,0xD4,0x00,0x6D,0x96,0xB5,0xB8,0x25,0x05,0x89,0x6C,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0xFE,0x3F};
uint8_t spQ[]             PROGMEM = {0x0E,0x98,0xD5,0x28,0x02,0x11,0x18,0xE9,0xCC,0x46,0x98,0xF1,0x66,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0xFF,0x0F};
uint8_t spR[]             PROGMEM = {0xAB,0xC8,0x72,0x33,0x93,0xBB,0xDC,0xEE,0xB6,0xB7,0xB9,0xF5,0x68,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0xFD,0x3F};
uint8_t spS[]             PROGMEM = {0x6B,0x6E,0xD9,0x34,0x6C,0xE6,0xDC,0xF6,0x36,0xB7,0xBE,0xF5,0x19,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0xF0,0xFF};
uint8_t spT[]             PROGMEM = {0x01,0xD8,0xB6,0xDD,0x01,0x2F,0xF4,0x38,0x60,0xD5,0xD1,0x91,0x4D,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0xFF,0x07};
uint8_t spU[]             PROGMEM = {0xA1,0x9F,0x9C,0x94,0x72,0x26,0x8D,0x76,0x07,0x55,0x90,0x78,0x3C,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0xFF,0x01};
uint8_t spV[]             PROGMEM = {0x66,0xF3,0xD2,0x38,0x43,0xB3,0xD8,0x2D,0xAC,0x4D,0xBB,0x70,0xB0,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0xFF,0x03};
uint8_t spW[]             PROGMEM = {0xA1,0xDE,0xC2,0x44,0xC2,0xFC,0x9C,0x6A,0x88,0x70,0x09,0x59,0x7B,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0xFF,0x07};
uint8_t spX[]             PROGMEM = {0xAD,0x68,0xC9,0xC5,0x32,0x56,0xDF,0xFA,0x54,0x2D,0x35,0x7B,0xF8,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0xFE,0x1F};
uint8_t spY[]             PROGMEM = {0x6A,0xB1,0xA2,0xA7,0x95,0xD2,0xD8,0x25,0x0F,0xA3,0x2D,0xB2,0x7A,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0xFA,0x7F};
uint8_t spZ[]             PROGMEM = {0x6D,0xFD,0xC6,0x5C,0x95,0xD5,0xF5,0xD5,0x02,0x7B,0x5D,0xFD,0x51,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0xFE,0x1F};


// female
uint8_t spF_THE[]       PROGMEM = {0x08,0xE8,0x3E,0x55,0x01,0xC3,0x86,0x27,0xAF,0x72,0x0D,0x4D,0x97,0xD5,0xBC,0x64,0x3C,0xF2,0x5C,0x51,0xF1,0x93,0x36,0x8F,0x4F,0x59,0x2A,0x42,0x7A,0x32,0xC3,0x64,0xFF,0x3F};
uint8_t spF_TIME[]      PROGMEM = {0x0E,0x28,0xAC,0x2D,0x01,0x5D,0xB6,0x0D,0x33,0xF3,0x54,0xB3,0x60,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0xFF,0x07};
uint8_t spF_IS[]        PROGMEM = {0x21,0x18,0x96,0x38,0xB7,0x14,0x8D,0x60,0x3A,0xA6,0xE8,0x51,0xB4,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0xFF,0x7F};

uint8_t spF_A_M_[]      PROGMEM = {0xCD,0xEF,0x86,0xAB,0x57,0x6D,0x0F,0xAF,0x71,0xAD,0x49,0x55,0x3C,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0xFF,0x3F};
uint8_t spF_P_M_[]      PROGMEM = {0x0E,0x98,0x41,0x54,0x00,0x43,0xA0,0x05,0xAB,0x42,0x8E,0x1D,0xA3,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0xFF,0x0F};

uint8_t spF_OH[]        PROGMEM = {0xC6,0xC9,0x71,0x5A,0xA2,0x92,0x14,0x2F,0x6E,0x97,0x9C,0x46,0x9D,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0xFF,0x01};
uint8_t spF_OCLOCK[]    PROGMEM = {0x21,0x4E,0x3D,0xB8,0x2B,0x19,0xBB,0x24,0x0E,0xE5,0xEC,0x60,0xE4,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0xFF,0x07};
uint8_t spF_ONE[]       PROGMEM = {0xCC,0x67,0x75,0x42,0x59,0x5D,0x3A,0x4F,0x9D,0x36,0x63,0xB7,0x59,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0xFF,0x0F};
uint8_t spF_TWO[]       PROGMEM = {0x0E,0x38,0x6E,0x25,0x00,0xA3,0x0D,0x3A,0xA0,0x37,0xC5,0xA0,0x05,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0xFF,0x0F};
uint8_t spF_THREE[]     PROGMEM = {0x02,0xD8,0x2E,0x9C,0x01,0xDB,0xA6,0x33,0x60,0xFB,0x30,0x01,0xEC,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0xFF,0x0F};
uint8_t spF_FOUR[]      PROGMEM = {0x0C,0x18,0xB6,0x9A,0x01,0xC3,0x75,0x09,0x60,0xD8,0x0E,0x09,0x30,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0xFF,0x07};
uint8_t spF_FIVE[]      PROGMEM = {0x02,0xE8,0x3E,0x8C,0x01,0xDD,0x65,0x08,0x60,0x98,0x4C,0x06,0x34,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0xFE,0x7F};
uint8_t spF_SIX[]       PROGMEM = {0x0E,0xD8,0xAE,0xDD,0x03,0x0E,0x38,0xA6,0xD2,0x01,0xD3,0xB4,0x2C,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0xFC,0x3F};
uint8_t spF_SEVEN[]     PROGMEM = {0x02,0xB8,0x3A,0x8C,0x01,0xDF,0xA4,0x73,0x40,0x01,0x47,0xB9,0x2F,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0xF3,0xFF};
uint8_t spF_EIGHT[]     PROGMEM = {0xC3,0x6C,0x86,0xB3,0x27,0x6D,0x0F,0xA7,0x48,0x99,0x4E,0x55,0x3C,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0xFE,0x1F};
uint8_t spF_NINE[]      PROGMEM = {0xCC,0xA1,0x26,0xBB,0x83,0x93,0x18,0xCF,0x4A,0xAD,0x2E,0x31,0xED,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0xFF,0x07};
uint8_t spF_TEN[]       PROGMEM = {0x0E,0xD8,0xB1,0xDD,0x01,0x3D,0xA8,0x24,0x7B,0x04,0x27,0x76,0x77,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0xFF,0x0F};
uint8_t spF_ELEVEN[]    PROGMEM = {0xC3,0xCD,0x76,0x5C,0xAE,0x14,0x0F,0x37,0x9B,0x71,0xDE,0x92,0x55,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0xFF,0x0F};
uint8_t spF_TWELVE[]    PROGMEM = {0x06,0x28,0x46,0xD3,0x01,0x25,0x06,0x13,0x20,0xBA,0x70,0x70,0xB6,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0xFF,0x0F};
uint8_t spF_THIRTEEN[]  PROGMEM = {0x08,0xE8,0x2C,0x15,0x01,0x43,0x07,0x13,0xE0,0x98,0xB4,0xA6,0x35,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0xFF,0x01};
uint8_t spF_FOURTEEN[]  PROGMEM = {0x0C,0x58,0xAE,0x5C,0x01,0xD9,0x87,0x07,0x51,0xB7,0x25,0xB3,0x8A,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0xF9,0xFF};
uint8_t spF_FIFTEEN[]   PROGMEM = {0x08,0xE8,0x2A,0x0D,0x01,0xDD,0xBA,0x31,0x60,0x6A,0xF7,0xA0,0xAE,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0xFF,0x07};
uint8_t spF_SIXTEEN[]   PROGMEM = {0x0A,0x58,0x5A,0x5D,0x00,0x93,0x97,0x0B,0x60,0xA9,0x48,0x05,0x0C,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0xFF,0x1F};
uint8_t spF_SEVENTEEN[] PROGMEM = {0x02,0x98,0x3A,0x42,0x00,0x5B,0xA6,0x09,0x60,0xDB,0x52,0x06,0x1C,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0xFD,0x3F};
uint8_t spF_EIGHTEEN[]  PROGMEM = {0x2E,0x9C,0xD1,0x4D,0x54,0xEC,0x2C,0xBF,0x1B,0x8A,0x99,0x70,0x7C,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0xF3,0xFF};
uint8_t spF_NINETEEN[]  PROGMEM = {0xC2,0xEA,0x8A,0x95,0x2B,0x6A,0x05,0x3F,0x71,0x71,0x5F,0x0D,0x12,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0xFF,0x1F};
uint8_t spF_TWENTY[]    PROGMEM = {0x01,0x98,0xD1,0xC2,0x00,0xCD,0xA4,0x32,0x20,0x79,0x13,0x04,0x28,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0xFF,0x0F};
uint8_t spF_THIRTY[]    PROGMEM = {0x08,0x98,0xD6,0x15,0x01,0x43,0xBB,0x0A,0x20,0x1B,0x8B,0xE5,0x16,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0xFF,0x01};
uint8_t spF_FOURTY[]    PROGMEM = {0x04,0x18,0xB6,0x4C,0x00,0xC3,0x56,0x30,0xA0,0xE8,0xF4,0xA0,0x98,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0xFF,0x01};
uint8_t spF_FIFTY[]     PROGMEM = {0x08,0xE8,0x2E,0x84,0x00,0x23,0x84,0x13,0x60,0x38,0x95,0xA5,0x0F,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0xFF,0x1F};
uint8_t spF_PAUSE1[]    PROGMEM = {0x00,0x00,0x00,0x00,0xFF,0x0F};

// male

uint8_t spM_ZERO[]     PROGMEM = {0x69, 0xFB, 0x59, 0xDD, 0x51, 0xD5, 0xD7, 0xB5, 0x6F, 0x0A, 0x78, 0xC0, 0x52,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 0xFF, 0x1F};
uint8_t spM_ONE[]      PROGMEM = {0x66, 0x4E, 0xA8, 0x7A, 0x8D, 0xED, 0xC4, 0xB5, 0xCD, 0x89, 0xD4, 0xBC, 0xA2,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 0xFE, 0x1F};
uint8_t spM_TWO[]      PROGMEM = {0x06, 0xB8, 0x59, 0x34, 0x00, 0x27, 0xD6, 0x38, 0x60, 0x58, 0xD3, 0x91, 0x55,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 0xFF, 0x1F};
uint8_t spM_THREE[]    PROGMEM = {0x0C, 0xE8, 0x2E, 0x94, 0x01, 0x4D, 0xBA, 0x4A, 0x40, 0x03, 0x16, 0x68, 0x69,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 0xFF, 0x03};
uint8_t spM_FOUR[]     PROGMEM = {0x08, 0x68, 0x21, 0x0D, 0x03, 0x04, 0x28, 0xCE, 0x92, 0x03, 0x23, 0x4A, 0xCA,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 0xF2, 0xFF};
uint8_t spM_FIVE[]     PROGMEM = {0x08, 0x68, 0x4E, 0x9D, 0x02, 0x1C, 0x60, 0xC0, 0x8C, 0x69, 0x12, 0xB0, 0xC0,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 0xFF, 0x01};
uint8_t spM_SIX[]      PROGMEM = {0x04, 0xF8, 0xAD, 0x4C, 0x02, 0x16, 0xB0, 0x80, 0x06, 0x56, 0x35, 0x5D, 0xA8,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 0xFF, 0x01};
uint8_t spM_SEVEN[]    PROGMEM = {0x0C, 0xF8, 0x5E, 0x4C, 0x01, 0xBF, 0x95, 0x7B, 0xC0, 0x02, 0x16, 0xB0, 0xC0,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 0xFB, 0x7F};
uint8_t spM_EIGHT[]    PROGMEM = {0x65, 0x69, 0x89, 0xC5, 0x73, 0x66, 0xDF, 0xE9, 0x8C, 0x33, 0x0E, 0x41, 0xC6,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 0xF8, 0x7F};
uint8_t spM_NINE[]     PROGMEM = {0xE6, 0xA8, 0x1A, 0x35, 0x5D, 0xD6, 0x9A, 0x35, 0x4B, 0x8C, 0x4E, 0x6B, 0x1A,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 0xFF, 0x0F};
uint8_t spM_TEN[]      PROGMEM = {0x0E, 0x38, 0x3C, 0x2D, 0x00, 0x5F, 0xB6, 0x19, 0x60, 0xA8, 0x90, 0x93, 0x36,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 0xFF, 0x03};
uint8_t spM_ELEVEN[]   PROGMEM = {0xA5, 0xEF, 0xD6, 0x50, 0x3B, 0x67, 0x8F, 0xB9, 0x3B, 0x23, 0x49, 0x7F, 0x33,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 0xFF, 0x0F};
uint8_t spM_TWELVE[]   PROGMEM = {0x09, 0x98, 0xDA, 0x22, 0x01, 0x37, 0x78, 0x1A, 0x20, 0x85, 0xD1, 0x50, 0x3A,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 0xFE, 0x1F};
uint8_t spM_THIR_[]    PROGMEM = {0x04, 0xA8, 0xBE, 0x5C, 0x00, 0xDD, 0xA5, 0x11, 0xA0, 0xFA, 0x72, 0x02, 0x74,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 0xFF, 0x03};
uint8_t spM_FIF_[]     PROGMEM = {0x08, 0x98, 0x31, 0x93, 0x02, 0x1C, 0xE0, 0x80, 0x07, 0x5A, 0xD6, 0x1C, 0x6B,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 0xFC, 0x3F};
uint8_t spM__TEEN[]    PROGMEM = {0x09, 0x58, 0x2A, 0x25, 0x00, 0xCB, 0x9F, 0x95, 0x6C, 0x14, 0x21, 0x89, 0xA9,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 0xFF, 0x3F};
uint8_t spM_TWENTY[]   PROGMEM = {0x0A, 0xE8, 0x4A, 0xCD, 0x01, 0xDB, 0xB9, 0x33, 0xC0, 0xA6, 0x54, 0x0C, 0xA4,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 0xFF, 0x1F};
uint8_t spM_T[]        PROGMEM = {0x01, 0xD8, 0xB6, 0xDD, 0x01, 0x2F, 0xF4, 0x38, 0x60, 0xD5, 0xD1, 0x91, 0x4D,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 0xFF, 0x07};
uint8_t spM_HUNDRED[]  PROGMEM = {0x04, 0xC8, 0x7E, 0x5C, 0x02, 0x0A, 0xA8, 0x62, 0x43, 0x03, 0xA7, 0xA8, 0x62,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 0xF9, 0x7F};
uint8_t spM_THOUSAND[] PROGMEM = {0x0C, 0xE8, 0x2E, 0xD4, 0x02, 0x06, 0x98, 0xD2, 0x55, 0x03, 0x16, 0x68, 0x7D,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 0xFF, 0x0F};
uint8_t spM_AND[]      PROGMEM = {0xA9, 0x6B, 0x21, 0xB9, 0x22, 0x66, 0x9F, 0xAE, 0xC7, 0xE1, 0x70, 0x7B, 0x72,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 0xFF, 0x3F};
uint8_t spM_MINUS[]    PROGMEM = {0xE6, 0x28, 0xC4, 0xF8, 0x44, 0x9A, 0xFB, 0xCD, 0xAD, 0x8D, 0x2A, 0x4E, 0x4A,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 0xFF, 0x03};
uint8_t spM_MILLI[]    PROGMEM = {0x6E, 0xF0, 0x8A, 0xB3, 0x4B, 0xEB, 0xC6, 0xAE, 0x36, 0xA7, 0x1A, 0x3A, 0x54,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 0xFF, 0x03};
uint8_t spM_VOLTS[]    PROGMEM = {0xA0, 0xDA, 0xA2, 0xB2, 0x3A, 0x44, 0x55, 0x9C, 0xFA, 0xB0, 0xBA, 0x46, 0x72,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 0xFC, 0x3F};
uint8_t spM_HERTZ[] PROGMEM = {0x08,0x28,0xA6,0x4B,0x00,0x55,0x56,0x23,0xA0,0x9A,0x99,0x12,0xE7,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0xFF,0x03};


//drum

uint8_t spS_BRUSH[]  PROGMEM = {0x1C,0xB0,0x80,0x05,0x34,0xE0,0x01,0x0D,0x10,0xA0,0x09,0x97,0xFF,0x07};
uint8_t spTCHH[]     PROGMEM = {0xE0,0x01,0x0D,0x10,0xA0,0x09,0x97,0xFF,0x07};

//bleeps

uint8_t spS_BLEEP1[]         PROGMEM = {0x05,0x34,0xE0,0x01,0x0D,0x10,0xA0,0x09,0x97,0xFF,0x07};
uint8_t spS_BLEEP2[]         PROGMEM = {0x34,0xE0,0x01,0x0D,0x10,0xA0,0x09,0x97,0xFF,0x07};

//dictionary

//TODO: do everything just before the say




//  4511
#define  LedA 12
#define  LedB 8
#define  LedC 9
#define  LedD 11

int mode=0;
boolean speaking = false;


/* Say any number between -999,999 and 999,999 */




void sayNumber(long n)
	{
	if(n<0)
		{
		voice.say(spM_MINUS);
		sayNumber(-n);
		}
	else if(n==0)
		{
		voice.say(spM_ZERO);
		}
	else
		{
		if(n>=1000)
			{
			int thousands = n / 1000;
			sayNumber(thousands);
			voice.say(spM_THOUSAND);
			n %= 1000;
			if((n > 0) && (n<100)) voice.say(spM_AND);
			}
		if(n>=100)
			{
			int hundreds = n / 100;
			sayNumber(hundreds);
			voice.say(spM_HUNDRED);
			n %= 100;
			if(n > 0) voice.say(spM_AND);
			}
		if(n>19)
			{
			int tens = n / 10;
			switch(tens)
				{
				case 2:
					voice.say(spM_TWENTY);
					break;
				case 3:
					voice.say(spM_THIR_);
					voice.say(spM_T);
					break;
				case 4:
					voice.say(spM_FOUR);
					voice.say(spM_T);
					break;
				case 5:
					voice.say(spM_FIF_);
					voice.say(spM_T);
					break;
				case 6:
					voice.say(spM_SIX);
					voice.say(spM_T);
					break;
				case 7:
					voice.say(spM_SEVEN);
					voice.say(spM_T);
					break;
				case 8:
					voice.say(spM_EIGHT);
					voice.say(spM_T);
					break;
				case 9:
					voice.say(spM_NINE);
					voice.say(spM_T);
					break;
				}
			n %= 10;
			}
		switch(n)
			{
			case 1:
				voice.say(spM_ONE);
				break;
			case 2:
				voice.say(spM_TWO);
				break;
			case 3:
				voice.say(spM_THREE);
				break;
			case 4:
				voice.say(spM_FOUR);
				break;
			case 5:
				voice.say(spM_FIVE);
				break;
			case 6:
				voice.say(spM_SIX);
				break;
			case 7:
				voice.say(spM_SEVEN);
				break;
			case 8:
				voice.say(spM_EIGHT);
				break;
			case 9:
				voice.say(spM_NINE);
				break;
			case 10:
				voice.say(spM_TEN);
				break;
			case 11:
				voice.say(spM_ELEVEN);
				break;
			case 12:
				voice.say(spM_TWELVE);
				break;
			case 13:
				voice.say(spM_THIR_);
				voice.say(spM__TEEN);
				break;
			case 14:
				voice.say(spM_FOUR);
				voice.say(spM__TEEN);
				break;
			case 15:
				voice.say(spM_FIF_);
				voice.say(spM__TEEN);
				break;
			case 16:
				voice.say(spM_SIX);
				voice.say(spM__TEEN);
				break;
			case 17:
				voice.say(spM_SEVEN);
				voice.say(spM__TEEN);
				break;
			case 18:
				voice.say(spM_EIGHT);
				voice.say(spM__TEEN);
				break;
			case 19:
				voice.say(spM_NINE);
				voice.say(spM__TEEN);
				break;
			}
		}
	}





void sayNumberF(long n)

	{

	if(n>19)
		{
		int tens = n / 10;
		switch(tens)
			{
			case 2:
				voice.say(spF_TWENTY);
				break;
			case 3:
				voice.say(spF_THIRTY);
				break;
			case 4:
				voice.say(spF_FOURTY);
				break;
			case 5:
				voice.say(spF_FIFTY);
				break;

			}
		n %= 10;
		}
	switch(n)
		{
		case 0:
			//   voice.say(spF_OH);
			break;
		case 1:
			voice.say(spF_ONE);
			break;
		case 2:
			voice.say(spF_TWO);
			break;
		case 3:
			voice.say(spF_THREE);
			break;
		case 4:
			voice.say(spF_FOUR);
			break;
		case 5:
			voice.say(spF_FIVE);
			break;
		case 6:
			voice.say(spF_SIX);
			break;
		case 7:
			voice.say(spF_SEVEN);
			break;
		case 8:
			voice.say(spF_EIGHT);
			break;
		case 9:
			voice.say(spF_NINE);
			break;
		case 10:
			voice.say(spF_TEN);
			break;
		case 11:
			voice.say(spF_ELEVEN);
			break;
		case 12:
			voice.say(spF_TWELVE);
			break;
		case 13:
			voice.say(spF_THIRTEEN);
			break;
		case 14:
			voice.say(spF_FOURTEEN);
			break;
		case 15:
			voice.say(spF_FIFTEEN);
			break;
		case 16:
			voice.say(spF_SIXTEEN);
			break;
		case 17:
			voice.say(spF_SEVENTEEN);
			break;
		case 18:
			voice.say(spF_EIGHTEEN);
			break;
		case 19:
			voice.say(spF_NINETEEN);
			break;
		}
	}



void voltmeter()
	{
	int voltage = analogRead(0) * 5.000 / 1.023;
	sayNumber(voltage);
	voice.say(spM_MILLI);
	voice.say(spM_VOLTS);
	}

void frequencemeter()
	{
	int hertz = analogRead(0) * 5.000 / 1.023;
	sayNumber(hertz);
	voice.say(spM_HERTZ);
	}


void nato()
	{
	int letter= map(analogRead(0),0,1000,1,26);





	switch(letter)
		{

		case 1:
			voice.say(spALPHA);
			break;
		case 2:
			voice.say(spBRAVO);
			break;
		case 3:
			voice.say(spCHARLIE);
			break;
		case 4:
			voice.say(spDELTA);
			break;
		case 5:
			voice.say(spECHO);
			break;
		case 6:
			voice.say(spFOXTROT);
			break;
		case 7:
			voice.say(spGOLF);
			break;
		case 8:
			voice.say(spHOTEL);
			break;
		case 9:
			voice.say(spINDIA);
			break;
		case 10:
			voice.say(spJULIET);
			break;
		case 11:
			voice.say(spKILO);
			break;
		case 12:
			voice.say(spLIMA);
			break;
		case 13:
			voice.say(spMIKE);
			break;
		case 14:
			voice.say(spNOVEMBER);
			break;
		case 15:
			voice.say(spOSCAR);
			break;
		case 16:
			voice.say(spPAPA);
			break;
		case 17:
			voice.say(spQUEBEC);
			break;
		case 18:
			voice.say(spROMEO);
			break;
		case 19:
			voice.say(spSIERRA);
			break;
		case 20:
			voice.say(spTANGO);
			break;
		case 21:
			voice.say(spUNIFORM);
			break;
		case 22:
			voice.say(spVICTOR);
			break;
		case 23:
			voice.say(spWHISKEY);
			break;
		case 24:
			voice.say(spXRAY);
			break;
		case 25:
			voice.say(spYANKEE);
			break;
		case 26:
			voice.say(spZULU);
			break;

		}
	}

void alphabet()
	{
	int letter= map(analogRead(0),0,1023,1,26);
	switch(letter)
		{

		case 1:
			voice.say(spA);
			break;
		case 2:
			voice.say(spB);
			break;
		case 3:
			voice.say(spC);
			break;
		case 4:
			voice.say(spD);
			break;
		case 5:
			voice.say(spE);
			break;
		case 6:
			voice.say(spF);
			break;
		case 7:
			voice.say(spG);
			break;
		case 8:
			voice.say(spH);
			break;
		case 9:
			voice.say(spI);
			break;
		case 10:
			voice.say(spJ);
			break;
		case 11:
			voice.say(spK);
			break;
		case 12:
			voice.say(spL);
			break;
		case 13:
			voice.say(spM);
			break;
		case 14:
			voice.say(spN);
			break;
		case 15:
			voice.say(spO);
			break;
		case 16:
			voice.say(spP);
			break;
		case 17:
			voice.say(spQ);
			break;
		case 18:
			voice.say(spR);
			break;
		case 19:
			voice.say(spS);
			break;
		case 20:
			voice.say(spT);
			break;
		case 21:
			voice.say(spU);
			break;
		case 22:
			voice.say(spV);
			break;
		case 23:
			voice.say(spW);
			break;
		case 24:
			voice.say(spX);
			break;
		case 25:
			voice.say(spY);
			break;
		case 26:
			voice.say(spZ);
			break;

		}
	}




void get_mode()
	{
	/*
	0:digits male voice
	1:digitsfemale voice
	2:big numbers (from 0 to 9999999)
	3:voltmeter (reading the CV voltage)
	4:frequencemeter (just saying "Hertz" instead of "Volts")
	5:Spell the alphabet
	6:nato alphabet
	7:strange sounds
	*/

	mode = map(analogRead(1),-100,1000,0,7);
	display(mode);
	}

void display(int n)
	{
	digitalWrite(LedD, ((n >> 3) & 1) ? HIGH : LOW);
	digitalWrite(LedC, ((n >> 2) & 1) ? HIGH : LOW);
	digitalWrite(LedB, ((n >> 1) & 1) ? HIGH : LOW);
	digitalWrite(LedA, (n & 1) ? HIGH : LOW);
	}

void setup()
	{

	Serial.begin(9600);


	pinMode(LedA, OUTPUT);
	pinMode(LedB, OUTPUT);
	pinMode(LedC, OUTPUT);
	pinMode(LedD, OUTPUT);


	pinMode(BEND, INPUT_PULLUP);
	pinMode(LOOP, INPUT_PULLUP);

	pinMode(TRIGGER, INPUT);

	}
void digits()
	{
	int n = map(analogRead(0),0,1000,0,9);
	sayNumber(n);
	}



void digitsF()
	{
	int n = map(analogRead(0),0,1000,0,9);
	sayNumberF(n);
	}

void bigNumbers()
	{
	long n = map(analogRead(0),0,1000,0,999999);
	sayNumber(n);
	}



void strange()
	{
	int sound= map(analogRead(0),0,1023,1,4);
	switch(sound)
		{

		case 1:
			voice.say(spS_BRUSH);
			break;
		case 2:
			voice.say(spTCHH);
			break;
		case 3:
			voice.say(spS_BLEEP1);
			break;
		case 4:
			voice.say(spS_BLEEP2);
			break;
		}
	}

void loop()
	{
	get_mode();

// if phrase mode whait here to trigger the phrase (but read mode change)
	if(digitalRead(LOOP)==0)

		{


		if(speaking == true)
			{
			while(digitalRead(TRIGGER)==1);
			delay(10); // debounce
			speaking=false; // not sure why it work without this !
			}





		do
			{
			get_mode();

			}

		while(digitalRead(TRIGGER)==0);
		speaking = true;



		}





	switch(mode)
		{

		case 0:
			digits();
			break;

		case 1:
			digitsF();
			break;
		case 2:
			bigNumbers();
			break;


		case 3:
			voltmeter();
			break;
		case 4:
			frequencemeter();
			break;
		case 5:
			alphabet();
			break;
		case 6:
			nato();
			break;
		case 7:
			strange();
			break;




		}
	}



