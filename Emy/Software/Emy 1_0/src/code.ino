// Talkie library by Adafruit : https://github.com/adafruit/Talkie version february 10, 2017
// ResponsiveAnalogRead library https://github.com/dxinteractive/ResponsiveAnalogRead version Mar 16, 2017
/*
   repeat mode in library (cfr Talko)
   define mode in library like in Talko



 */

#include "talkie.h"
#include "5220_alphon.h"
#include <Adafruit_GFX.h>
#include <Adafruit_SSD1306.h>
#include <Kfonts.h>
#include <Wire.h>
#include <Encoder.h>
#include "SAMD_AnalogCorrection.h"
//#include <Average.h>

//#include <ResponsiveAnalogRead.h> // attention modif ligne 64     int analogResolution = 1024;

const unsigned char Eye [] PROGMEM = {
        0x00, 0x00, 0x00, 0x00, 0x00, 0x00, 0x00, 0x00, 0x07, 0xe0, 0x18, 0x38, 0x39, 0x9c, 0x49, 0x92,
        0x49, 0x92, 0x38, 0x1c, 0x1c, 0x78, 0x07, 0xc0, 0x00, 0x00, 0x00, 0x00, 0x00, 0x00, 0x00, 0x00
};


/*

   ██   ██  █████  ██████  ██████  ██     ██  █████  ██████  ███████
   ██   ██ ██   ██ ██   ██ ██   ██ ██     ██ ██   ██ ██   ██ ██
   ███████ ███████ ██████  ██   ██ ██  █  ██ ███████ ██████  █████
   ██   ██ ██   ██ ██   ██ ██   ██ ██ ███ ██ ██   ██ ██   ██ ██
   ██   ██ ██   ██ ██   ██ ██████   ███ ███  ██   ██ ██   ██ ███████

 */

#define SW0 0
#define SW1 1
#define GATE 2
#define PUSH 3
#define ROTA 6
#define ROTB 7
#define BLUE_LED  12
#define RED_LED 13

/*

   ██    ██  █████  ██████  ██  █████  ██████  ██      ███████ ███████
   ██    ██ ██   ██ ██   ██ ██ ██   ██ ██   ██ ██      ██      ██
   ██    ██ ███████ ██████  ██ ███████ ██████  ██      █████   ███████
   ██  ██  ██   ██ ██   ██ ██ ██   ██ ██   ██ ██      ██           ██
   ████   ██   ██ ██   ██ ██ ██   ██ ██████  ███████ ███████ ███████

 */

#define VERSION "Ver. 1.0"



#define GATE_HIGH !digitalRead(GATE)

//const uint8_t *alphons[72]  = {sp_alphon1,sp_alphon2,sp_alphon3,sp_alphon4,sp_alphon5,sp_alphon6,sp_alphon7,sp_alphon8,sp_alphon9,sp_alphon10,sp_alphon11,sp_alphon12,sp_alphon13,sp_alphon14,sp_alphon15,sp_alphon16,sp_alphon17,sp_alphon18,sp_alphon19,sp_alphon20,sp_alphon21,sp_alphon22,sp_alphon23,sp_alphon24,sp_alphon25,sp_alphon26,sp_alphon27,sp_alphon28,sp_alphon29,sp_alphon30,sp_alphon31,sp_alphon32,sp_alphon33,sp_alphon34,sp_alphon35,sp_alphon36,sp_alphon37,sp_alphon38,sp_alphon39,sp_alphon40,sp_alphon41,sp_alphon42,sp_alphon43,sp_alphon44,sp_alphon45,sp_alphon46,sp_alphon47,sp_alphon48,sp_alphon49,sp_alphon50,sp_alphon51,sp_alphon52,sp_alphon53,sp_alphon54,sp_alphon55,sp_alphon56,sp_alphon57,sp_alphon58,sp_alphon59,sp_alphon60,sp_alphon61,sp_alphon62,sp_alphon63,sp_alphon64,sp_alphon65,sp_alphon66,sp_alphon67,sp_alphon68,sp_alphon69,sp_alphon70,sp_alphon71,sp_alphon7};

const uint8_t *alphons[125]={sp_alphon1,sp_alphon2,sp_alphon3,sp_alphon4,sp_alphon5,sp_alphon6,sp_alphon7,sp_alphon8,sp_alphon9,sp_alphon10,sp_alphon11,sp_alphon12,sp_alphon13,sp_alphon14,sp_alphon15,sp_alphon16,sp_alphon17,sp_alphon18,sp_alphon19,sp_alphon20,sp_alphon21,sp_alphon22,sp_alphon23,sp_alphon24,sp_alphon25,sp_alphon26,sp_alphon27,sp_alphon28,sp_alphon29,sp_alphon30,sp_alphon31,sp_alphon32,sp_alphon33,sp_alphon34,sp_alphon35,sp_alphon36,sp_alphon37,sp_alphon38,sp_alphon39,sp_alphon40,sp_alphon41,sp_alphon42,sp_alphon43,sp_alphon44,sp_alphon45,sp_alphon46,sp_alphon47,sp_alphon48,sp_alphon49,sp_alphon50,sp_alphon51,sp_alphon52,sp_alphon53,sp_alphon54,sp_alphon55,sp_alphon56,sp_alphon57,sp_alphon58,sp_alphon59,sp_alphon60,sp_alphon61,sp_alphon62,sp_alphon63,sp_alphon64,sp_alphon65,sp_alphon66,sp_alphon67,sp_alphon68,sp_alphon69,sp_alphon70,sp_alphon71,sp_alphon72,sp_alphon73,sp_alphon74,sp_alphon75,sp_alphon76,sp_alphon77,sp_alphon78,sp_alphon79,sp_alphon80,sp_alphon81,sp_alphon82,sp_alphon83,sp_alphon84,sp_alphon85,sp_alphon86,sp_alphon87,sp_alphon88,sp_alphon89,sp_alphon90,sp_alphon91,sp_alphon92,sp_alphon93,sp_alphon94,sp_alphon95,sp_alphon96,sp_alphon97,sp_alphon98,sp_alphon99,sp_alphon100,sp_alphon101,sp_alphon102,sp_alphon103,sp_alphon104,sp_alphon105,sp_alphon106,sp_alphon107,sp_alphon108,sp_alphon109,sp_alphon110,sp_alphon111,sp_alphon112,sp_alphon113,sp_alphon114,sp_alphon115,sp_alphon116,sp_alphon117,sp_alphon118,sp_alphon119,sp_alphon120,sp_alphon121,sp_alphon122,sp_alphon123,sp_alphon124,sp_alphon125};
const char *alloL[]  ={"AE1","AE1N","AH1","AH1N","AW1","AW1N","E1","E1N","EH1","EH1N","ER1N","I1","I1N","OO1","OW1N","U1","U1N","UH1","UH1M","UH1N","Y1","Y1N","ER1","OW1","Y2","AE2","AH2","AI2","AR2","AU2","AW2","E2","EER2","EH2","EHR2","EI2","ER2","I2","OI2","OO2","OOR2","OR2","OW2","U2","UH2","UU2","AE3","AH3","AI3","AR3","AU3","AW3","E3","EELL","EER3","EH3","EHR3","EI3","ER3","I3","ILL","ING2","OI3","OO3","OOR3","OR3","OW3","U3","UH3","ULL","UHL","UU3","L","L-","LL","M","MM","N","NN","NG1","NG2","R","W","WH","Y","B","BB","D","DD","G1","G2","GG","J","JJ","THV","THV-","V","VV","Z","ZZ","ZH","ZH-","K2","KH","KH-","KH1","KH2","P","PH","PH-","T","TH","TH-","CH","F","FF","HI","HO","HUH","S","SS","SH","SH-","THF","THF-","Pause1","Pause2"};

int allo;
int prevAllo;

bool busy=0;
int moy;


volatile float interruptCount=0; // The rotary counter
char* mainFunctions[12]={

        "Phoneme",
        "Numbers",
        "Numbers 2",
        "Set Time","","",""
};

#define numFunctions 4
int function;

bool WTF; // to avoid led interrupt trigger by rotary !

int fin =0; /// pour pression longue

/*

   ██████  ██████       ██ ███████  ██████ ████████ ███████
   ██    ██ ██   ██      ██ ██      ██         ██    ██
   ██    ██ ██████       ██ █████   ██         ██    ███████
   ██    ██ ██   ██ ██   ██ ██      ██         ██         ██
   ██████  ██████   █████  ███████  ██████    ██    ███████

 */
Adafruit_SSD1306 display(0); // modif library for 64
Talkie voice;
Encoder myEnc(6, 7);



/*

   ███████ ██    ██ ███    ██  ██████ ████████ ██  ██████  ███    ██ ███████
   ██      ██    ██ ████   ██ ██         ██    ██ ██    ██ ████   ██ ██
   █████   ██    ██ ██ ██  ██ ██         ██    ██ ██    ██ ██ ██  ██ ███████
   ██      ██    ██ ██  ██ ██ ██         ██    ██ ██    ██ ██  ██ ██      ██
   ██       ██████  ██   ████  ██████    ██    ██  ██████  ██   ████ ███████

 */



int potRead(int pot)
{
        moy=0;
        for (int i = 0; i < 10; i++) {
                moy=moy +analogRead(pot);
              //  moy=moy +analogReadFast(pot,2);
        }
        return moy/10;

}

void displayFunctionList(int p)
{

        display.clearDisplay();

        display.setCursor(0,12);
        display.print(">");
        for (int i = 0; i<4; i++) {  // nbr of lines to display

                display.setCursor(12,i*16+12); //
                String str2=mainFunctions[i+p];
                display.print(str2);


        }
        display.display();

}


void rot()
{


        // delayMicroseconds(1000);
        if(digitalRead(ROTA))

                if(digitalRead(ROTB)) { interruptCount=interruptCount-0.5; }
                else
                {

                        interruptCount=interruptCount+0.5;
                }

}



void readSound()

{
        allo=map(potRead(6),4095,0,0,9);
        if (allo!=prevAllo)
        {
                prevAllo=allo;
                display.clearDisplay();
                display.setFont(&Orbitron_Light_22);
                display.setTextSize(1);
                display.setCursor(0,16);
                display.print(allo+1);
                display.setFont(&Orbitron_Light_24);
                display.setCursor(0,40);
                display.setTextSize(1);
                display.print(alloL[allo]);
                display.display();
        }
}

void setBLUE_ON()
{
        if (WTF) { // sorry but I cannot find how to stop this interrupt from happening when turning the rotary

                if (digitalRead(GATE))
                {
                        digitalWrite(BLUE_LED,HIGH);
                }
                else
                {
                        digitalWrite(BLUE_LED,LOW);
                }
        }
}


void splashScreen()
{
        display.clearDisplay();
        display.setFont(&Orbitron_Bold_14);
        display.setCursor(0,0);
        display.setTextColor(WHITE);
        // display.setTextSize(2);
        display.println("Polaxis");
        display.display();
        delay(500);

        //  display.setTextSize(3);
        display.setCursor(0,22);
        display.println("Emy");
//display.setTextSize(2);
        display.setCursor(0,50);
        display.println(VERSION);
        display.display();
        delay(1500);
}











const uint8_t spZERO[]     PROGMEM = {0x69, 0xFB, 0x59, 0xDD, 0x51, 0xD5, 0xD7, 0xB5, 0x6F, 0x0A, 0x78, 0xC0, 0x52,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 0xFF, 0x1F};
const uint8_t spONE[]      PROGMEM = {0x66, 0x4E, 0xA8, 0x7A, 0x8D, 0xED, 0xC4, 0xB5, 0xCD, 0x89, 0xD4, 0xBC, 0xA2,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 0xFE, 0x1F};
const uint8_t spTWO[]      PROGMEM = {0x06, 0xB8, 0x59, 0x34, 0x00, 0x27, 0xD6, 0x38, 0x60, 0x58, 0xD3, 0x91, 0x55,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 0xFF, 0x1F};
const uint8_t spTHREE[]    PROGMEM = {0x0C, 0xE8, 0x2E, 0x94, 0x01, 0x4D, 0xBA, 0x4A, 0x40, 0x03, 0x16, 0x68, 0x69,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 0xFF, 0x03};
const uint8_t spFOUR[]     PROGMEM = {0x08, 0x68, 0x21, 0x0D, 0x03, 0x04, 0x28, 0xCE, 0x92, 0x03, 0x23, 0x4A, 0xCA,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 0xF2, 0xFF};
const uint8_t spFIVE[]     PROGMEM = {0x08, 0x68, 0x4E, 0x9D, 0x02, 0x1C, 0x60, 0xC0, 0x8C, 0x69, 0x12, 0xB0, 0xC0,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 0xFF, 0x01};
const uint8_t spSIX[]      PROGMEM = {0x04, 0xF8, 0xAD, 0x4C, 0x02, 0x16, 0xB0, 0x80, 0x06, 0x56, 0x35, 0x5D, 0xA8,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 0xFF, 0x01};
const uint8_t spSEVEN[]    PROGMEM = {0x0C, 0xF8, 0x5E, 0x4C, 0x01, 0xBF, 0x95, 0x7B, 0xC0, 0x02, 0x16, 0xB0, 0xC0,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 0xFB, 0x7F};
const uint8_t spEIGHT[]    PROGMEM = {0x65, 0x69, 0x89, 0xC5, 0x73, 0x66, 0xDF, 0xE9, 0x8C, 0x33, 0x0E, 0x41, 0xC6,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 0xF8, 0x7F};
const uint8_t spNINE[]     PROGMEM = {0xE6, 0xA8, 0x1A, 0x35, 0x5D, 0xD6, 0x9A, 0x35, 0x4B, 0x8C, 0x4E, 0x6B, 0x1A,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 0xFF, 0x0F};
const uint8_t spTEN[]      PROGMEM = {0x0E, 0x38, 0x3C, 0x2D, 0x00, 0x5F, 0xB6, 0x19, 0x60, 0xA8, 0x90, 0x93, 0x36,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 0xFF, 0x03};
const uint8_t spELEVEN[]   PROGMEM = {0xA5, 0xEF, 0xD6, 0x50, 0x3B, 0x67, 0x8F, 0xB9, 0x3B, 0x23, 0x49, 0x7F, 0x33,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 0xFF, 0x0F};
const uint8_t spTWELVE[]   PROGMEM = {0x09, 0x98, 0xDA, 0x22, 0x01, 0x37, 0x78, 0x1A, 0x20, 0x85, 0xD1, 0x50, 0x3A,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 0xFE, 0x1F};
const uint8_t spTHIR_[]    PROGMEM = {0x04, 0xA8, 0xBE, 0x5C, 0x00, 0xDD, 0xA5, 0x11, 0xA0, 0xFA, 0x72, 0x02, 0x74,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 0xFF, 0x03};
const uint8_t spFIF_[]     PROGMEM = {0x08, 0x98, 0x31, 0x93, 0x02, 0x1C, 0xE0, 0x80, 0x07, 0x5A, 0xD6, 0x1C, 0x6B,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 0xFC, 0x3F};
const uint8_t sp_TEEN[]    PROGMEM = {0x09, 0x58, 0x2A, 0x25, 0x00, 0xCB, 0x9F, 0x95, 0x6C, 0x14, 0x21, 0x89, 0xA9,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 0xFF, 0x3F};
const uint8_t spTWENTY[]   PROGMEM = {0x0A, 0xE8, 0x4A, 0xCD, 0x01, 0xDB, 0xB9, 0x33, 0xC0, 0xA6, 0x54, 0x0C, 0xA4,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 0xFF, 0x1F};
const uint8_t spT[]        PROGMEM = {0x01, 0xD8, 0xB6, 0xDD, 0x01, 0x2F, 0xF4, 0x38, 0x60, 0xD5, 0xD1, 0x91, 0x4D,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 0xFF, 0x07};
const uint8_t spHUNDRED[]  PROGMEM = {0x04, 0xC8, 0x7E, 0x5C, 0x02, 0x0A, 0xA8, 0x62, 0x43, 0x03, 0xA7, 0xA8, 0x62,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 0xF9, 0x7F};
const uint8_t spTHOUSAND[] PROGMEM = {0x0C, 0xE8, 0x2E, 0xD4, 0x02, 0x06, 0x98, 0xD2, 0x55, 0x03, 0x16, 0x68, 0x7D,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 0xFF, 0x0F};
const uint8_t spAND[]      PROGMEM = {0xA9, 0x6B, 0x21, 0xB9, 0x22, 0x66, 0x9F, 0xAE, 0xC7, 0xE1, 0x70, 0x7B, 0x72,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 0xFF, 0x3F};
const uint8_t spMINUS[]    PROGMEM = {0xE6, 0x28, 0xC4, 0xF8, 0x44, 0x9A, 0xFB, 0xCD, 0xAD, 0x8D, 0x2A, 0x4E, 0x4A,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 0xFF, 0x03};
const uint8_t spMILLI[]    PROGMEM = {0x6E, 0xF0, 0x8A, 0xB3, 0x4B, 0xEB, 0xC6, 0xAE, 0x36, 0xA7, 0x1A, 0x3A, 0x54,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 0xFF, 0x03};
const uint8_t spVOLTS[]    PROGMEM = {0xA0, 0xDA, 0xA2, 0xB2, 0x3A, 0x44, 0x55, 0x9C, 0xFA, 0xB0, 0xBA, 0x46, 0x72,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 0xFC, 0x3F};

const uint8_t spYOU_ARE_FIRED[]    PROGMEM =

{0xe8,0xa8,0x52,0xcc,0x52,0xa2,0x8a,0xbc,0x70,0x96,0x38,0x0f,0xa3,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0xff,0xff};

/* Say any number between -999,999 and 999,999 */
void sayNumber(long n) {
        if (n<0) {
                voice.say(spMINUS);
                sayNumber(-n);
        } else if (n==0) {
                voice.say(spZERO);
        } else {
                if (n>=1000) {
                        int thousands = n / 1000;
                        sayNumber(thousands);
                        voice.say(spTHOUSAND);
                        n %= 1000;
                        if ((n > 0) && (n<100)) voice.say(spAND);
                }
                if (n>=100) {
                        int hundreds = n / 100;
                        sayNumber(hundreds);
                        voice.say(spHUNDRED);
                        n %= 100;
                        if (n > 0) voice.say(spAND);
                }
                if (n>19) {
                        int tens = n / 10;
                        switch (tens) {
                        case 2: voice.say(spTWENTY); break;
                        case 3: voice.say(spTHIR_); voice.say(spT); break;
                        case 4: voice.say(spFOUR); voice.say(spT);  break;
                        case 5: voice.say(spFIF_);  voice.say(spT); break;
                        case 6: voice.say(spSIX);  voice.say(spT); break;
                        case 7: voice.say(spSEVEN);  voice.say(spT); break;
                        case 8: voice.say(spEIGHT);  voice.say(spT); break;
                        case 9: voice.say(spNINE);  voice.say(spT); break;
                        }
                        n %= 10;
                }
                switch(n) {
                case 1: voice.say(spONE); break;
                case 2: voice.say(spTWO); break;
                case 3: voice.say(spTHREE); break;
                case 4: voice.say(spFOUR); break;
                case 5: voice.say(spFIVE); break;
                case 6: voice.say(spSIX); break;
                case 7: voice.say(spSEVEN); break;
                case 8: voice.say(spEIGHT); break;
                case 9: voice.say(spNINE); break;
                case 10: voice.say(spTEN); break;
                case 11: voice.say(spELEVEN); break;
                case 12: voice.say(spTWELVE); break;
                case 13: voice.say(spTHIR_); voice.say(sp_TEEN); break;
                case 14: voice.say(spFOUR); voice.say(sp_TEEN); break;
                case 15: voice.say(spFIF_); voice.say(sp_TEEN); break;
                case 16: voice.say(spSIX); voice.say(sp_TEEN); break;
                case 17: voice.say(spSEVEN); voice.say(sp_TEEN); break;
                case 18: voice.say(spEIGHT); voice.say(sp_TEEN); break;
                case 19: voice.say(spNINE); voice.say(sp_TEEN); break;
                }
        }
}


/*

   ███████ ███████ ████████ ██    ██ ██████
   ██      ██         ██    ██    ██ ██   ██
   ███████ █████      ██    ██    ██ ██████
        ██ ██         ██    ██    ██ ██
   ███████ ███████    ██     ██████  ██

 */
void setup() {



        pinMode(SW0, INPUT_PULLUP);
        pinMode(SW1, INPUT_PULLUP);
        pinMode(ROTA, INPUT_PULLUP);
        pinMode(ROTB, INPUT_PULLUP);
        pinMode(PUSH, INPUT_PULLUP);
        pinMode(GATE, INPUT_PULLUP);
        pinMode(BLUE_LED,OUTPUT);
        pinMode(RED_LED,OUTPUT);
        // turn transistorized outputs low ;
        digitalWrite(BLUE_LED,HIGH);
        digitalWrite(RED_LED,HIGH);

        analogReadResolution(12);
        analogReadCorrection(14, 2065);
        //  analogSound.setAnalogResolution(4096);

        display.begin(SSD1306_SWITCHCAPVCC, 0x3C); // initialize with the I2C addr 0x3D (for the 128x64)
        display.clearDisplay();

        display.drawBitmap(35,0, Eye, 16, 16, WHITE);
        display.drawBitmap(75,0, Eye, 16, 16, WHITE);
        display.display();
        delay(500);
        //splashScreen();

        Serial.begin(115200);

        display.clearDisplay();
        display.setTextSize(2);
        display.setTextColor(WHITE);
        display.display();



      //  voice.say(spYOU_ARE_FIRED);

        Wire.setClock(2000000L);  //magnifique ! ? plante à 3mhz
        //  attachInterrupt(GATE, setBLUE_ON, CHANGE);
        attachInterrupt(ROTA, rot, CHANGE);


}

/*

   ██       ██████   ██████  ██████
   ██      ██    ██ ██    ██ ██   ██
   ██      ██    ██ ██    ██ ██████
   ██      ██    ██ ██    ██ ██
   ███████  ██████   ██████  ██

 */

void loop() {

        // get ready to grab new function

        digitalWrite(BLUE_LED,HIGH);
        detachInterrupt(GATE);
        WTF=LOW;
        delay(300);
        interruptCount=0;
        display.setFont(&Orbitron_Light_16);
        display.setTextSize(1);

        // grab function

        do {

                interruptCount=constrain(interruptCount,0,numFunctions-1);

                function=interruptCount;
                displayFunctionList(function);



        } while(digitalRead(PUSH));
        delay(400);
      // attachInterrupt(GATE, setBLUE_ON, CHANGE);
        WTF=HIGH;

// process functions

        switch (function)
        {
        case 0: // Allophones
        {
                fin=0; // reset long presss counter
                prevAllo=9999; //to force display at startup

                do {



                        voice.mode=digitalRead(SW0)+digitalRead(SW1)*2;
                        // while(digitalRead(GATE)==0) ; //to avoid repeat in speech mode)
                        do {

                                //     readSound(); // to display while gate is low helps to set sequence
                        }
                        while(digitalRead(GATE)==1 && digitalRead(PUSH)==1 );
                        moy=0;
                        for (int i = 0; i < 10; i++) {
                                moy=moy +analogRead(A6);
                        }
                        allo=map(moy/10,4095,0,0,124);
                        voice.say(alphons[allo]);

                        if (allo!=prevAllo)
                        {
                                prevAllo=allo;
                                display.clearDisplay();
                                display.setFont(&Orbitron_Light_22);
                                display.setTextSize(1);
                                display.setCursor(0,16);
                                display.print(allo+1);
                                display.setFont(&Orbitron_Light_24);
                                display.setCursor(0,40);
                                display.setTextSize(1);
                                display.print(alloL[allo]);
                                display.display();
                        }
                        fin=0;
                        do {
                                fin++;
                                if (fin>100000L) break;
                        } while(digitalRead(PUSH)==0);

                } while(fin<100000L); // long presss
                display.clearDisplay();
                display.display();

        }
        break;

        case 1: // Numbers
        {
                fin=0; // reset long presss counter
                prevAllo=9999; //to force display at startup

                do {



                        voice.mode=digitalRead(SW0)+digitalRead(SW1)*2;
                        //  if (mode==2) while(digitalRead(GATE)==0) ; //to avoid repeat in speech mode)

                        do {
                                //  Serial.println(digitalRead(SW0)+digitalRead(SW1)*2);
                                readSound(); // to display while gate is low helps to set sequence
                        }
                        while(digitalRead(GATE)==1);

                        allo=map(potRead(6),4095,0,0,9);

                        sayNumber(allo);
                        if (allo!=prevAllo)
                        {
                                prevAllo=allo;
                                display.clearDisplay();
                                display.setFont(&Orbitron_Light_22);
                                display.setTextSize(1);
                                display.setCursor(0,16);
                                display.print(allo);
                                display.setFont(&Orbitron_Light_24);
                                display.setCursor(0,40);
                                display.setTextSize(1);
                                display.print(allo);
                                display.display();
                        }

                        do {
                                fin++;

                                //  Serial.println(fin);
                                if (fin>100000L) break;
                        } while(digitalRead(PUSH)==0);

                } while(fin<100000L); // long presss
                display.clearDisplay();
                display.display();

        }
        break;

        case 2: // Number 2
        {

                prevAllo=9999; //to force display at startup

                do {
                        fin=0; // reset long presss counter

                        voice.mode=digitalRead(SW0)+digitalRead(SW1)*2;
                        allo=map(potRead(6),4095,10,0,9);


                        if (allo!=prevAllo)
                        {
                                prevAllo=allo;
                                display.clearDisplay();
                                display.setFont(&Orbitron_Light_22);
                                display.setTextSize(1);
                                display.setCursor(0,16);
                                display.print(allo);
                                display.setFont(&Orbitron_Light_24);
                                display.setCursor(0,40);
                                display.setTextSize(1);
                                display.print(allo);
                                display.display();
                        }


                        //  if (digitalRead(GATE)==ON || digitalRead(PUSH)==ON)

                        if (voice.mode==MODE_SPEECH)

                      {
                                if (digitalRead(GATE)==ON || digitalRead(PUSH)==ON)
                                {

                                        digitalWrite(RED_LED,ON);
                                        sayNumber(allo);
                                        digitalWrite(RED_LED,OFF);
                                }
                        }
                        else
                        {
                                sayNumber(allo);
                        }



                        do {
                                fin++;

                                //  Serial.println(fin);
                                if (fin>100000L) break;
                        } while(digitalRead(PUSH)==0);

                } while(fin<100000L); // long presss
                display.clearDisplay();
                display.display();

        }
        break;



        }



}



/*
   ██████  ██████   ██████  ██
   ██   ██ ██   ██ ██    ██ ██
   ██████  ██████  ██    ██ ██
   ██   ██ ██   ██ ██    ██ ██
   ██████  ██   ██  ██████  ███████
 */

/*
      //  if (GATE_HIGH)
      //  {
                switch (voice.mode)
                {
                case MODE_SPEECH:

                        {
                        if (!voice.talking() && busy==0)
                        {
                                if(!busy) voice.say(alphons[allo]);
                                busy=1;
                        }

                        break;
                      }

                case MODE_REPEAT:
                        voice.say(alphons[allo],false);
                        break;


                }
 */
//}
//  else
//{
//        busy=0; // si mode speech
//        //  if (MODE_REPEAT) voice.say(sp_alphon127);// si mode 3 stop sound
//  }
