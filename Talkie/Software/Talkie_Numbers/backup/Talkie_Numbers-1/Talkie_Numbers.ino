// Talkie library
// Copyright 2011 Peter Knight
// This code is released under GPLv2 license.
//
//
// A female voice with an American accent
//
//todo mettre des resistance de pull down pour que ce soit les niveaux haut qui activen
// voir si on boucle dans le code ou la lib ?
// ajouter un pot speed
// migrer le hack pitch dans la lib
// ramener la lib dans le code !



#include "talkie.h"

Talkie voice;

// female
uint8_t spF_THE[]       PROGMEM = {0x08,0xE8,0x3E,0x55,0x01,0xC3,0x86,0x27,0xAF,0x72,0x0D,0x4D,0x97,0xD5,0xBC,0x64,0x3C,0xF2,0x5C,0x51,0xF1,0x93,0x36,0x8F,0x4F,0x59,0x2A,0x42,0x7A,0x32,0xC3,0x64,0xFF,0x3F};
uint8_t spF_TIME[]      PROGMEM = {0x0E,0x28,0xAC,0x2D,0x01,0x5D,0xB6,0x0D,0x33,0xF3,0x54,0xB3,0x60,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0xFF,0x07};
uint8_t spF_IS[]        PROGMEM = {0x21,0x18,0x96,0x38,0xB7,0x14,0x8D,0x60,0x3A,0xA6,0xE8,0x51,0xB4,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0xFF,0x7F};

uint8_t spF_A_M_[]      PROGMEM = {0xCD,0xEF,0x86,0xAB,0x57,0x6D,0x0F,0xAF,0x71,0xAD,0x49,0x55,0x3C,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0xFF,0x3F};
uint8_t spF_P_M_[]      PROGMEM = {0x0E,0x98,0x41,0x54,0x00,0x43,0xA0,0x05,0xAB,0x42,0x8E,0x1D,0xA3,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0xFF,0x0F};

uint8_t spF_OH[]        PROGMEM = {0xC6,0xC9,0x71,0x5A,0xA2,0x92,0x14,0x2F,0x6E,0x97,0x9C,0x46,0x9D,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0xFF,0x01};
uint8_t spF_OCLOCK[]    PROGMEM = {0x21,0x4E,0x3D,0xB8,0x2B,0x19,0xBB,0x24,0x0E,0xE5,0xEC,0x60,0xE4,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0xFF,0x07};
uint8_t spF_ONE[]       PROGMEM = {0xCC,0x67,0x75,0x42,0x59,0x5D,0x3A,0x4F,0x9D,0x36,0x63,0xB7,0x59,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0xFF,0x0F};
uint8_t spF_TWO[]       PROGMEM = {0x0E,0x38,0x6E,0x25,0x00,0xA3,0x0D,0x3A,0xA0,0x37,0xC5,0xA0,0x05,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0xFF,0x0F};
uint8_t spF_THREE[]     PROGMEM = {0x02,0xD8,0x2E,0x9C,0x01,0xDB,0xA6,0x33,0x60,0xFB,0x30,0x01,0xEC,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0xFF,0x0F};
uint8_t spF_FOUR[]      PROGMEM = {0x0C,0x18,0xB6,0x9A,0x01,0xC3,0x75,0x09,0x60,0xD8,0x0E,0x09,0x30,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0xFF,0x07};
uint8_t spF_FIVE[]      PROGMEM = {0x02,0xE8,0x3E,0x8C,0x01,0xDD,0x65,0x08,0x60,0x98,0x4C,0x06,0x34,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0xFE,0x7F};
uint8_t spF_SIX[]       PROGMEM = {0x0E,0xD8,0xAE,0xDD,0x03,0x0E,0x38,0xA6,0xD2,0x01,0xD3,0xB4,0x2C,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0xFC,0x3F};
uint8_t spF_SEVEN[]     PROGMEM = {0x02,0xB8,0x3A,0x8C,0x01,0xDF,0xA4,0x73,0x40,0x01,0x47,0xB9,0x2F,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0xF3,0xFF};
uint8_t spF_EIGHT[]     PROGMEM = {0xC3,0x6C,0x86,0xB3,0x27,0x6D,0x0F,0xA7,0x48,0x99,0x4E,0x55,0x3C,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0xFE,0x1F};
uint8_t spF_NINE[]      PROGMEM = {0xCC,0xA1,0x26,0xBB,0x83,0x93,0x18,0xCF,0x4A,0xAD,0x2E,0x31,0xED,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0xFF,0x07};
uint8_t spF_TEN[]       PROGMEM = {0x0E,0xD8,0xB1,0xDD,0x01,0x3D,0xA8,0x24,0x7B,0x04,0x27,0x76,0x77,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0xFF,0x0F};
uint8_t spF_ELEVEN[]    PROGMEM = {0xC3,0xCD,0x76,0x5C,0xAE,0x14,0x0F,0x37,0x9B,0x71,0xDE,0x92,0x55,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0xFF,0x0F};
uint8_t spF_TWELVE[]    PROGMEM = {0x06,0x28,0x46,0xD3,0x01,0x25,0x06,0x13,0x20,0xBA,0x70,0x70,0xB6,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0xFF,0x0F};
uint8_t spF_THIRTEEN[]  PROGMEM = {0x08,0xE8,0x2C,0x15,0x01,0x43,0x07,0x13,0xE0,0x98,0xB4,0xA6,0x35,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0xFF,0x01};
uint8_t spF_FOURTEEN[]  PROGMEM = {0x0C,0x58,0xAE,0x5C,0x01,0xD9,0x87,0x07,0x51,0xB7,0x25,0xB3,0x8A,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0xF9,0xFF};
uint8_t spF_FIFTEEN[]   PROGMEM = {0x08,0xE8,0x2A,0x0D,0x01,0xDD,0xBA,0x31,0x60,0x6A,0xF7,0xA0,0xAE,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0xFF,0x07};
uint8_t spF_SIXTEEN[]   PROGMEM = {0x0A,0x58,0x5A,0x5D,0x00,0x93,0x97,0x0B,0x60,0xA9,0x48,0x05,0x0C,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0xFF,0x1F};
uint8_t spF_SEVENTEEN[] PROGMEM = {0x02,0x98,0x3A,0x42,0x00,0x5B,0xA6,0x09,0x60,0xDB,0x52,0x06,0x1C,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0xFD,0x3F};
uint8_t spF_EIGHTEEN[]  PROGMEM = {0x2E,0x9C,0xD1,0x4D,0x54,0xEC,0x2C,0xBF,0x1B,0x8A,0x99,0x70,0x7C,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0xF3,0xFF};
uint8_t spF_NINETEEN[]  PROGMEM = {0xC2,0xEA,0x8A,0x95,0x2B,0x6A,0x05,0x3F,0x71,0x71,0x5F,0x0D,0x12,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0xFF,0x1F};
uint8_t spF_TWENTY[]    PROGMEM = {0x01,0x98,0xD1,0xC2,0x00,0xCD,0xA4,0x32,0x20,0x79,0x13,0x04,0x28,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0xFF,0x0F};
uint8_t spF_THIRTY[]    PROGMEM = {0x08,0x98,0xD6,0x15,0x01,0x43,0xBB,0x0A,0x20,0x1B,0x8B,0xE5,0x16,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0xFF,0x01};
uint8_t spF_FOURTY[]    PROGMEM = {0x04,0x18,0xB6,0x4C,0x00,0xC3,0x56,0x30,0xA0,0xE8,0xF4,0xA0,0x98,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0xFF,0x01};
uint8_t spF_FIFTY[]     PROGMEM = {0x08,0xE8,0x2E,0x84,0x00,0x23,0x84,0x13,0x60,0x38,0x95,0xA5,0x0F,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0xFF,0x1F};
uint8_t spF_PAUSE1[]    PROGMEM = {0x00,0x00,0x00,0x00,0xFF,0x0F};

// male

uint8_t spM_ZERO[]     PROGMEM = {0x69, 0xFB, 0x59, 0xDD, 0x51, 0xD5, 0xD7, 0xB5, 0x6F, 0x0A, 0x78, 0xC0, 0x52,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 0xFF, 0x1F};
uint8_t spM_ONE[]      PROGMEM = {0x66, 0x4E, 0xA8, 0x7A, 0x8D, 0xED, 0xC4, 0xB5, 0xCD, 0x89, 0xD4, 0xBC, 0xA2,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 0xFE, 0x1F};
uint8_t spM_TWO[]      PROGMEM = {0x06, 0xB8, 0x59, 0x34, 0x00, 0x27, 0xD6, 0x38, 0x60, 0x58, 0xD3, 0x91, 0x55,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 0xFF, 0x1F};
uint8_t spM_THREE[]    PROGMEM = {0x0C, 0xE8, 0x2E, 0x94, 0x01, 0x4D, 0xBA, 0x4A, 0x40, 0x03, 0x16, 0x68, 0x69,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 0xFF, 0x03};
uint8_t spM_FOUR[]     PROGMEM = {0x08, 0x68, 0x21, 0x0D, 0x03, 0x04, 0x28, 0xCE, 0x92, 0x03, 0x23, 0x4A, 0xCA,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 0xF2, 0xFF};
uint8_t spM_FIVE[]     PROGMEM = {0x08, 0x68, 0x4E, 0x9D, 0x02, 0x1C, 0x60, 0xC0, 0x8C, 0x69, 0x12, 0xB0, 0xC0,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 0xFF, 0x01};
uint8_t spM_SIX[]      PROGMEM = {0x04, 0xF8, 0xAD, 0x4C, 0x02, 0x16, 0xB0, 0x80, 0x06, 0x56, 0x35, 0x5D, 0xA8,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 0xFF, 0x01};
uint8_t spM_SEVEN[]    PROGMEM = {0x0C, 0xF8, 0x5E, 0x4C, 0x01, 0xBF, 0x95, 0x7B, 0xC0, 0x02, 0x16, 0xB0, 0xC0,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 0xFB, 0x7F};
uint8_t spM_EIGHT[]    PROGMEM = {0x65, 0x69, 0x89, 0xC5, 0x73, 0x66, 0xDF, 0xE9, 0x8C, 0x33, 0x0E, 0x41, 0xC6,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 0xF8, 0x7F};
uint8_t spM_NINE[]     PROGMEM = {0xE6, 0xA8, 0x1A, 0x35, 0x5D, 0xD6, 0x9A, 0x35, 0x4B, 0x8C, 0x4E, 0x6B, 0x1A,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 0xFF, 0x0F};
uint8_t spM_TEN[]      PROGMEM = {0x0E, 0x38, 0x3C, 0x2D, 0x00, 0x5F, 0xB6, 0x19, 0x60, 0xA8, 0x90, 0x93, 0x36,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 0xFF, 0x03};
uint8_t spM_ELEVEN[]   PROGMEM = {0xA5, 0xEF, 0xD6, 0x50, 0x3B, 0x67, 0x8F, 0xB9, 0x3B, 0x23, 0x49, 0x7F, 0x33,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 0xFF, 0x0F};
uint8_t spM_TWELVE[]   PROGMEM = {0x09, 0x98, 0xDA, 0x22, 0x01, 0x37, 0x78, 0x1A, 0x20, 0x85, 0xD1, 0x50, 0x3A,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 0xFE, 0x1F};
uint8_t spM_THIR_[]    PROGMEM = {0x04, 0xA8, 0xBE, 0x5C, 0x00, 0xDD, 0xA5, 0x11, 0xA0, 0xFA, 0x72, 0x02, 0x74,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 0xFF, 0x03};
uint8_t spM_FIF_[]     PROGMEM = {0x08, 0x98, 0x31, 0x93, 0x02, 0x1C, 0xE0, 0x80, 0x07, 0x5A, 0xD6, 0x1C, 0x6B,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 0xFC, 0x3F};
uint8_t spM__TEEN[]    PROGMEM = {0x09, 0x58, 0x2A, 0x25, 0x00, 0xCB, 0x9F, 0x95, 0x6C, 0x14, 0x21, 0x89, 0xA9,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 0xFF, 0x3F};
uint8_t spM_TWENTY[]   PROGMEM = {0x0A, 0xE8, 0x4A, 0xCD, 0x01, 0xDB, 0xB9, 0x33, 0xC0, 0xA6, 0x54, 0x0C, 0xA4,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 0xFF, 0x1F};
uint8_t spM_T[]        PROGMEM = {0x01, 0xD8, 0xB6, 0xDD, 0x01, 0x2F, 0xF4, 0x38, 0x60, 0xD5, 0xD1, 0x91, 0x4D,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 0xFF, 0x07};
uint8_t spM_HUNDRED[]  PROGMEM = {0x04, 0xC8, 0x7E, 0x5C, 0x02, 0x0A, 0xA8, 0x62, 0x43, 0x03, 0xA7, 0xA8, 0x62,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 0xF9, 0x7F};
uint8_t spM_THOUSAND[] PROGMEM = {0x0C, 0xE8, 0x2E, 0xD4, 0x02, 0x06, 0x98, 0xD2, 0x55, 0x03, 0x16, 0x68, 0x7D,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 0xFF, 0x0F};
uint8_t spM_AND[]      PROGMEM = {0xA9, 0x6B, 0x21, 0xB9, 0x22, 0x66, 0x9F, 0xAE, 0xC7, 0xE1, 0x70, 0x7B, 0x72,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 0xFF, 0x3F};
uint8_t spM_MINUS[]    PROGMEM = {0xE6, 0x28, 0xC4, 0xF8, 0x44, 0x9A, 0xFB, 0xCD, 0xAD, 0x8D, 0x2A, 0x4E, 0x4A,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 0xFF, 0x03};
uint8_t spM_MILLI[]    PROGMEM = {0x6E, 0xF0, 0x8A, 0xB3, 0x4B, 0xEB, 0xC6, 0xAE, 0x36, 0xA7, 0x1A, 0x3A, 0x54,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 0xFF, 0x03};
uint8_t spM_VOLTS[]    PROGMEM = {0xA0, 0xDA, 0xA2, 0xB2, 0x3A, 0x44, 0x55, 0x9C, 0xFA, 0xB0, 0xBA, 0x46, 0x72,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 0xFC, 0x3F};


#define GENDER 4
#define LED 9
// #define RESET 7 garder l'option si besoin d'un reset apr�s le triger qui ne s'arreterais que si on reset
#define TRIGGER 5

int mode=0;

/* Say any number between -999,999 and 999,999 */
void sayNumber(long n) {
  if (n<0) {
    //voice.say(spM_MINUS);
    sayNumber(-n);
  } else if (n==0) {
    voice.say(spM_ZERO);
  } else {
    if (n>=1000) {
      int thousands = n / 1000;
      sayNumber(thousands);
      voice.say(spM_THOUSAND);
      n %= 1000;
      if ((n > 0) && (n<100)) voice.say(spM_AND);
    }
    if (n>=100) {
      int hundreds = n / 100;
      sayNumber(hundreds);
      voice.say(spM_HUNDRED);
      n %= 100;
      if (n > 0) voice.say(spM_AND);
    }
    if (n>19) {
      int tens = n / 10;
      switch (tens) {
        case 2: voice.say(spM_TWENTY); break;
        case 3: voice.say(spM_THIR_); voice.say(spM_T); break;
        case 4: voice.say(spM_FOUR); voice.say(spM_T);  break;
        case 5: voice.say(spM_FIF_);  voice.say(spM_T); break;
        case 6: voice.say(spM_SIX);  voice.say(spM_T); break;
        case 7: voice.say(spM_SEVEN);  voice.say(spM_T); break;
        case 8: voice.say(spM_EIGHT);  voice.say(spM_T); break;
        case 9: voice.say(spM_NINE);  voice.say(spM_T); break;
      }
      n %= 10;
    }
    switch(n) {
      case 1: voice.say(spM_ONE); break;
      case 2: voice.say(spM_TWO); break;
      case 3: voice.say(spM_THREE); break;
      case 4: voice.say(spM_FOUR); break;
      case 5: voice.say(spM_FIVE); break;
      case 6: voice.say(spM_SIX); break;
      case 7: voice.say(spM_SEVEN); break;
      case 8: voice.say(spM_EIGHT); break;
      case 9: voice.say(spM_NINE); break;
      case 10: voice.say(spM_TEN); break;
      case 11: voice.say(spM_ELEVEN); break;
      case 12: voice.say(spM_TWELVE); break;
      case 13: voice.say(spM_THIR_); voice.say(spM__TEEN); break;
      case 14: voice.say(spM_FOUR); voice.say(spM__TEEN);break;
      case 15: voice.say(spM_FIF_); voice.say(spM__TEEN); break;
      case 16: voice.say(spM_SIX); voice.say(spM__TEEN); break;
      case 17: voice.say(spM_SEVEN); voice.say(spM__TEEN); break;
      case 18: voice.say(spM_EIGHT); voice.say(spM__TEEN); break;
      case 19: voice.say(spM_NINE); voice.say(spM__TEEN); break;
    }
  }
}








void setup() {

pinMode(LED, OUTPUT);
pinMode(GENDER, INPUT_PULLUP);

pinMode(TRIGGER, INPUT_PULLUP);
//pinMode(RESET, INPUT_PULLUP);

digitalWrite(LED, HIGH);
delay(500);
digitalWrite(LED, LOW);
  	
}
void loop() {
  digitalWrite(LED, LOW);
  boolean sex=digitalRead(GENDER);
 
 switch  (mode)
 {
 case 0:
 
if (sex)
  {
   voice.say(spF_THIRTY);
   
  }
  else
  {
     voice.say(spM_ONE);
   
  }
 break;
 
 
 
 
 
 case 1:
 int voltage = analogRead(1) * 5.000 / 1.023;
  
  sayNumber(voltage);

} 
}



